/dts-v1/;

/ {
	model = "QRD";
	qcom,board-id = <0x1000b 0x4>;

	__fixups__ {
		blsp1_uart2 = "/fragment@0:target:0";
		cam_sensor_front1_default = "/fragment@1/__overlay__/qcom,eeprom@2:pinctrl-0:8", "/fragment@1/__overlay__/qcom,camera@2:pinctrl-0:8";
		cam_sensor_front1_sleep = "/fragment@1/__overlay__/qcom,eeprom@2:pinctrl-1:8", "/fragment@1/__overlay__/qcom,camera@2:pinctrl-1:8";
		cam_sensor_mclk0_default = "/fragment@1/__overlay__/qcom,eeprom@0:pinctrl-0:0", "/fragment@1/__overlay__/qcom,camera@0:pinctrl-0:0";
		cam_sensor_mclk0_sleep = "/fragment@1/__overlay__/qcom,eeprom@0:pinctrl-1:0", "/fragment@1/__overlay__/qcom,camera@0:pinctrl-1:0";
		cam_sensor_mclk2_default = "/fragment@1/__overlay__/qcom,eeprom@2:pinctrl-0:0", "/fragment@1/__overlay__/qcom,camera@2:pinctrl-0:0";
		cam_sensor_mclk2_sleep = "/fragment@1/__overlay__/qcom,eeprom@2:pinctrl-1:0", "/fragment@1/__overlay__/qcom,camera@2:pinctrl-1:0";
		cam_sensor_rear_default = "/fragment@1/__overlay__/qcom,eeprom@0:pinctrl-0:8", "/fragment@1/__overlay__/qcom,camera@0:pinctrl-0:8";
		cam_sensor_rear_sleep = "/fragment@1/__overlay__/qcom,eeprom@0:pinctrl-1:8", "/fragment@1/__overlay__/qcom,camera@0:pinctrl-1:8";
		cam_sensor_rear_vdig_qm215 = "/fragment@1/__overlay__/qcom,eeprom@0:pinctrl-0:4", "/fragment@1/__overlay__/qcom,eeprom@2:pinctrl-0:4", "/fragment@1/__overlay__/qcom,camera@0:pinctrl-0:4", "/fragment@1/__overlay__/qcom,camera@2:pinctrl-0:4";
		cam_sensor_rear_vdig_sleep_qm215 = "/fragment@1/__overlay__/qcom,eeprom@0:pinctrl-1:4", "/fragment@1/__overlay__/qcom,eeprom@2:pinctrl-1:4", "/fragment@1/__overlay__/qcom,camera@0:pinctrl-1:4", "/fragment@1/__overlay__/qcom,camera@2:pinctrl-1:4";
		cci = "/fragment@1:target:0";
		clock_gcc = "/fragment@1/__overlay__/qcom,eeprom@0:clocks:0", "/fragment@1/__overlay__/qcom,eeprom@0:clocks:8", "/fragment@1/__overlay__/qcom,eeprom@2:clocks:0", "/fragment@1/__overlay__/qcom,eeprom@2:clocks:8", "/fragment@1/__overlay__/qcom,camera@0:clocks:0", "/fragment@1/__overlay__/qcom,camera@0:clocks:8", "/fragment@1/__overlay__/qcom,camera@2:clocks:0", "/fragment@1/__overlay__/qcom,camera@2:clocks:8", "/fragment@34/__overlay__/nq@28:clocks:0";
		fpc_int_low = "/fragment@5/__overlay__/fpc1020:pinctrl-2:0";
		fpc_reset_high = "/fragment@5/__overlay__/fpc1020:pinctrl-1:0";
		fpc_reset_low = "/fragment@5/__overlay__/fpc1020:pinctrl-0:0";
		gpio_key_active = "/fragment@5/__overlay__/gpio_keys:pinctrl-0:0";
		i2c_5 = "/fragment@34:target:0";
		mdss_dsi = "/fragment@35:target:0";
		mdss_dsi0 = "/fragment@18/__overlay__/qcom,mdss_dsi_hx8394f_720p_video:qcom,mdss-dsi-panel-controller:0", "/fragment@19/__overlay__/qcom,mdss_dsi_adv7533_1080p:qcom,mdss-dsi-panel-controller:0", "/fragment@20/__overlay__/qcom,mdss_dsi_adv7533_720p:qcom,mdss-dsi-panel-controller:0", "/fragment@25/__overlay__/qcom,mdss_dsi_icn9706_720_1440p_video:qcom,mdss-dsi-panel-controller:0", "/fragment@26/__overlay__/qcom,mdss_dsi_edo_rm67162_qvga_cmd:qcom,mdss-dsi-panel-controller:0", "/fragment@27/__overlay__/qcom,mdss_dsi_boe_icnl9706_800p_video:qcom,mdss-dsi-panel-controller:0", "/fragment@28/__overlay__/qcom,mdss_dsi_inx_jd9365_800p_video:qcom,mdss-dsi-panel-controller:0", "/fragment@29/__overlay__/qcom,mdss_dsi_inx_ili9881c_800p_video:qcom,mdss-dsi-panel-controller:0", "/fragment@30/__overlay__/qcom,mdss_dsi_hx8252_800p_video:qcom,mdss-dsi-panel-controller:0", "/fragment@36:target:0";
		mdss_dsi_active = "/fragment@8:target:0", "/fragment@36/__overlay__:pinctrl-0:0";
		mdss_dsi_suspend = "/fragment@9:target:0", "/fragment@36/__overlay__:pinctrl-1:0";
		mdss_mdp = "/fragment@10:target:0", "/fragment@11:target:0", "/fragment@12:target:0", "/fragment@13:target:0", "/fragment@14:target:0", "/fragment@15:target:0", "/fragment@16:target:0", "/fragment@17:target:0", "/fragment@18:target:0", "/fragment@19:target:0", "/fragment@20:target:0", "/fragment@21:target:0", "/fragment@22:target:0", "/fragment@23:target:0", "/fragment@24:target:0", "/fragment@25:target:0", "/fragment@26:target:0", "/fragment@27:target:0", "/fragment@28:target:0", "/fragment@29:target:0", "/fragment@30:target:0", "/fragment@32:target:0";
		mdss_te_active = "/fragment@36/__overlay__:pinctrl-0:4";
		mdss_te_suspend = "/fragment@36/__overlay__:pinctrl-1:4";
		nfc_disable_active = "/fragment@34/__overlay__/nq@28:pinctrl-0:4";
		nfc_disable_suspend = "/fragment@34/__overlay__/nq@28:pinctrl-1:4";
		nfc_int_active = "/fragment@34/__overlay__/nq@28:pinctrl-0:0";
		nfc_int_suspend = "/fragment@34/__overlay__/nq@28:pinctrl-1:0";
		pm8916_bms = "/fragment@3:target:0";
		pm8916_chg = "/fragment@2:target:0";
		pm8916_gpios = "/fragment@33:target:0", "/fragment@34/__overlay__/nq@28:qcom,nq-clkreq:0";
		pm8916_l10 = "/fragment@1/__overlay__/qcom,actuator@0:cam_vaf-supply:0", "/fragment@1/__overlay__/qcom,eeprom@0:cam_vaf-supply:0", "/fragment@1/__overlay__/qcom,eeprom@2:cam_vaf-supply:0", "/fragment@1/__overlay__/qcom,camera@0:cam_vaf-supply:0", "/fragment@1/__overlay__/qcom,camera@2:cam_vaf-supply:0";
		pm8916_l11 = "/fragment@7/__overlay__:vdd-supply:0";
		pm8916_l12 = "/fragment@7/__overlay__:vdd-io-supply:0";
		pm8916_l16 = "/fragment@1/__overlay__/qcom,eeprom@0:cam_vana-supply:0", "/fragment@1/__overlay__/qcom,eeprom@2:cam_vana-supply:0", "/fragment@1/__overlay__/qcom,camera@0:cam_vana-supply:0", "/fragment@1/__overlay__/qcom,camera@2:cam_vana-supply:0";
		pm8916_l5 = "/fragment@5/__overlay__/fpc1020:vcc_spi-supply:0", "/fragment@5/__overlay__/fpc1020:vdd_io-supply:0", "/fragment@5/__overlay__/fpc1020:vdd_ana-supply:0", "/fragment@6/__overlay__:vdd-io-supply:0";
		pm8916_l6 = "/fragment@1/__overlay__/qcom,eeprom@0:cam_vio-supply:0", "/fragment@1/__overlay__/qcom,eeprom@2:cam_vio-supply:0", "/fragment@1/__overlay__/qcom,camera@0:cam_vio-supply:0", "/fragment@1/__overlay__/qcom,camera@2:cam_vio-supply:0";
		pm8916_l8 = "/fragment@6/__overlay__:vdd-supply:0";
		pm8916_mpps = "/fragment@22/__overlay__/qcom,mdss_dsi_hx8399c_hd_video:qcom,mdss-dsi-pwm-gpio:0";
		pm8916_vib = "/fragment@4:target:0";
		qrd_batterydata = "/fragment@3/__overlay__:qcom,battery-data:0";
		sdc1_clk_off = "/fragment@6/__overlay__:pinctrl-1:0";
		sdc1_clk_on = "/fragment@6/__overlay__:pinctrl-0:0";
		sdc1_cmd_off = "/fragment@6/__overlay__:pinctrl-1:4";
		sdc1_cmd_on = "/fragment@6/__overlay__:pinctrl-0:4";
		sdc1_data_off = "/fragment@6/__overlay__:pinctrl-1:8";
		sdc1_data_on = "/fragment@6/__overlay__:pinctrl-0:8";
		sdc1_rclk_off = "/fragment@6/__overlay__:pinctrl-1:12";
		sdc1_rclk_on = "/fragment@6/__overlay__:pinctrl-0:12";
		sdc2_cd_on = "/fragment@7/__overlay__:pinctrl-0:12";
		sdc2_clk_off = "/fragment@7/__overlay__:pinctrl-1:0";
		sdc2_clk_on = "/fragment@7/__overlay__:pinctrl-0:0";
		sdc2_cmd_off = "/fragment@7/__overlay__:pinctrl-1:4";
		sdc2_cmd_on = "/fragment@7/__overlay__:pinctrl-0:4";
		sdc2_data_off = "/fragment@7/__overlay__:pinctrl-1:8";
		sdc2_data_on = "/fragment@7/__overlay__:pinctrl-0:8";
		sdhc_1 = "/fragment@6:target:0";
		sdhc_2 = "/fragment@7:target:0";
		soc = "/fragment@5:target:0", "/fragment@31:target:0";
		tlmm = "/fragment@1/__overlay__/qcom,eeprom@0:gpios:0", "/fragment@1/__overlay__/qcom,eeprom@0:gpios:12", "/fragment@1/__overlay__/qcom,eeprom@0:gpios:24", "/fragment@1/__overlay__/qcom,eeprom@2:gpios:0", "/fragment@1/__overlay__/qcom,eeprom@2:gpios:12", "/fragment@1/__overlay__/qcom,eeprom@2:gpios:24", "/fragment@1/__overlay__/qcom,camera-flash:gpios:0", "/fragment@1/__overlay__/qcom,camera-flash:gpios:12", "/fragment@1/__overlay__/qcom,camera@0:gpios:0", "/fragment@1/__overlay__/qcom,camera@0:gpios:12", "/fragment@1/__overlay__/qcom,camera@0:gpios:24", "/fragment@1/__overlay__/qcom,camera@2:gpios:0", "/fragment@1/__overlay__/qcom,camera@2:gpios:12", "/fragment@1/__overlay__/qcom,camera@2:gpios:24", "/fragment@5/__overlay__/gpio_keys/vol_up:gpios:0", "/fragment@5/__overlay__/fpc1020:interrupt-parent:0", "/fragment@5/__overlay__/fpc1020:fpc,gpio_rst:0", "/fragment@5/__overlay__/fpc1020:fpc,gpio_irq:0", "/fragment@7/__overlay__:cd-gpios:0", "/fragment@34/__overlay__/nq@28:qcom,nq-irq:0", "/fragment@34/__overlay__/nq@28:qcom,nq-ven:0", "/fragment@34/__overlay__/nq@28:qcom,nq-firm:0", "/fragment@34/__overlay__/nq@28:interrupt-parent:0", "/fragment@36/__overlay__:qcom,platform-te-gpio:0", "/fragment@36/__overlay__:qcom,platform-reset-gpio:0", "/fragment@36/__overlay__:qcom,platform-bklight-en-gpio:0", "/fragment@36/__overlay__:qcom,platform-enable-gpio:0";
		uart_console_active = "/fragment@0/__overlay__:pinctrl-0:0";
	};

	__local_fixups__ {

		fragment@1 {

			__overlay__ {

				qcom,camera@0 {
					qcom,actuator-src = <0x0>;
					qcom,eeprom-src = <0x0>;
					qcom,led-flash-src = <0x0>;
				};

				qcom,camera@2 {
					qcom,eeprom-src = <0x0>;
				};
			};
		};

		fragment@22 {

			__overlay__ {

				qcom,mdss_dsi_hx8399c_hd_video {
					qcom,panel-supply-entries = <0x0>;
				};
			};
		};

		fragment@34 {

			__overlay__ {

				nq@28 {
					pinctrl-0 = <0x8>;
				};
			};
		};

		fragment@36 {

			__overlay__ {
				qcom,dsi-pref-prim-pan = <0x0>;
			};
		};
	};

	__symbols__ {
		actuator0 = "/fragment@1/__overlay__/qcom,actuator@0";
		dsi_adv7533_1080p = "/fragment@19/__overlay__/qcom,mdss_dsi_adv7533_1080p";
		dsi_adv7533_720p = "/fragment@20/__overlay__/qcom,mdss_dsi_adv7533_720p";
		dsi_boe_icnl9706_800p_video = "/fragment@27/__overlay__/qcom,mdss_dsi_boe_icnl9706_800p_video";
		dsi_edo_rm67162_qvga_cmd = "/fragment@26/__overlay__/qcom,mdss_dsi_edo_rm67162_qvga_cmd";
		dsi_hx8252_800p_video = "/fragment@30/__overlay__/qcom,mdss_dsi_hx8252_800p_video";
		dsi_hx8394f_720p_video = "/fragment@18/__overlay__/qcom,mdss_dsi_hx8394f_720p_video";
		dsi_hx8399c_hd_vid = "/fragment@22/__overlay__/qcom,mdss_dsi_hx8399c_hd_video";
		dsi_hx8399c_truly_vid = "/fragment@21/__overlay__/qcom,mdss_dsi_hx8399c_truly_video";
		dsi_icn9706_720_1440_vid = "/fragment@25/__overlay__/qcom,mdss_dsi_icn9706_720_1440p_video";
		dsi_inx_ili9881c_800p_video = "/fragment@29/__overlay__/qcom,mdss_dsi_inx_ili9881c_800p_video";
		dsi_inx_jd9365_800p_video = "/fragment@28/__overlay__/qcom,mdss_dsi_inx_jd9365_800p_video";
		dsi_nt35695b_truly_fhd_cmd = "/fragment@24/__overlay__/qcom,mdss_dsi_nt35695b_truly_fhd_cmd";
		dsi_nt35695b_truly_fhd_video = "/fragment@23/__overlay__/qcom,mdss_dsi_nt35695b_truly_fhd_video";
		dsi_panel_pwr_supply = "/fragment@31/__overlay__/dsi_panel_pwr_supply";
		dsi_pm660_panel_pwr_supply = "/fragment@31/__overlay__/dsi_pm660_panel_pwr_supply";
		dsi_r69006_1080p_cmd = "/fragment@16/__overlay__/qcom,mdss_dsi_r69006_1080p_cmd";
		dsi_r69006_1080p_video = "/fragment@17/__overlay__/qcom,mdss_dsi_r69006_1080p_video";
		dsi_sim_cmd = "/fragment@11/__overlay__/qcom,mdss_dsi_sim_cmd";
		dsi_sim_vid = "/fragment@10/__overlay__/qcom,mdss_dsi_sim_video";
		dsi_truly_1080_cmd = "/fragment@13/__overlay__/qcom,mdss_dsi_truly_1080p_cmd";
		dsi_truly_1080_vid = "/fragment@12/__overlay__/qcom,mdss_dsi_truly_1080p_video";
		dsi_truly_720_cmd = "/fragment@15/__overlay__/qcom,mdss_dsi_truly_720p_cmd";
		dsi_truly_720_vid = "/fragment@14/__overlay__/qcom,mdss_dsi_truly_720p_video";
		eeprom0 = "/fragment@1/__overlay__/qcom,eeprom@0";
		eeprom2 = "/fragment@1/__overlay__/qcom,eeprom@2";
		flash0 = "/fragment@1/__overlay__/qcom,camera-flash";
		nfc_clk_default = "/fragment@33/__overlay__/nfc_clk/nfc_clk_default";
	};

	fragment@0 {
		target = <0xffffffff>;

		__overlay__ {
			pinctrl-0 = <0xffffffff>;
			pinctrl-names = "default";
			status = "ok";
		};
	};

	fragment@1 {
		target = <0xffffffff>;

		__overlay__ {
			#address-cells = <0x1>;
			#size-cells = <0x0>;

			qcom,actuator@0 {
				cam_vaf-supply = <0xffffffff>;
				cell-index = <0x0>;
				compatible = "qcom,actuator";
				phandle = <0x2>;
				qcom,cam-vreg-max-voltage = <0x2b7cd0>;
				qcom,cam-vreg-min-voltage = <0x2b7cd0>;
				qcom,cam-vreg-name = "cam_vaf";
				qcom,cam-vreg-op-mode = <0x13880>;
				qcom,cci-master = <0x0>;
				reg = <0x0>;
			};

			qcom,camera-flash {
				cell-index = <0x0>;
				compatible = "qcom,qm215-gpio-flash";
				gpios = <0xffffffff 0x22 0x0 0xffffffff 0x21 0x0>;
				phandle = <0x1>;
				qcom,flash-type = <0x2>;
				qcom,gpio-flash-en = <0x0>;
				qcom,gpio-flash-now = <0x1>;
				qcom,gpio-req-tbl-flags = <0x1 0x0>;
				qcom,gpio-req-tbl-label = "CAM_FLASH", "CAM_TORCH";
				qcom,gpio-req-tbl-num = <0x0 0x1>;
				status = "ok";
			};

			qcom,camera@0 {
				cam_vaf-supply = <0xffffffff>;
				cam_vana-supply = <0xffffffff>;
				cam_vio-supply = <0xffffffff>;
				cell-index = <0x0>;
				clock-names = "cam_src_clk", "cam_clk";
				clocks = <0xffffffff 0x266b3853 0xffffffff 0x80902deb>;
				compatible = "qcom,camera";
				gpios = <0xffffffff 0x19 0x0 0xffffffff 0x1a 0x0 0xffffffff 0x24 0x0>;
				pinctrl-0 = <0xffffffff 0xffffffff 0xffffffff>;
				pinctrl-1 = <0xffffffff 0xffffffff 0xffffffff>;
				pinctrl-names = "cam_default", "cam_suspend";
				qcom,actuator-src = <0x2>;
				qcom,cam-vreg-max-voltage = <0x0 0x2ab980 0x2b7cd0>;
				qcom,cam-vreg-min-voltage = <0x0 0x2ab980 0x2b7cd0>;
				qcom,cam-vreg-name = "cam_vio", "cam_vana", "cam_vaf";
				qcom,cam-vreg-op-mode = <0x0 0x13880 0x186a0>;
				qcom,cci-master = <0x0>;
				qcom,clock-rates = <0x16e3600 0x0>;
				qcom,csid-sd-index = <0x0>;
				qcom,csiphy-sd-index = <0x0>;
				qcom,eeprom-src = <0x3>;
				qcom,gpio-req-tbl-flags = <0x1 0x0 0x0>;
				qcom,gpio-req-tbl-label = "CAM_VDIG", "CAMIF_MCLK0", "CAM_RESET0";
				qcom,gpio-req-tbl-num = <0x0 0x1 0x2>;
				qcom,gpio-reset = <0x2>;
				qcom,gpio-vdig = <0x0>;
				qcom,led-flash-src = <0x1>;
				qcom,mount-angle = <0x5a>;
				qcom,sensor-mode = <0x0>;
				qcom,sensor-position = <0x0>;
				reg = <0x0>;
			};

			qcom,camera@2 {
				cam_vaf-supply = <0xffffffff>;
				cam_vana-supply = <0xffffffff>;
				cam_vio-supply = <0xffffffff>;
				cell-index = <0x2>;
				clock-names = "cam_src_clk", "cam_clk";
				clocks = <0xffffffff 0x42545468 0xffffffff 0x222f8fff>;
				compatible = "qcom,camera";
				gpios = <0xffffffff 0x19 0x0 0xffffffff 0x1c 0x0 0xffffffff 0x28 0x0>;
				pinctrl-0 = <0xffffffff 0xffffffff 0xffffffff>;
				pinctrl-1 = <0xffffffff 0xffffffff 0xffffffff>;
				pinctrl-names = "cam_default", "cam_suspend";
				qcom,cam-vreg-max-voltage = <0x0 0x2ab980 0x2b7cd0>;
				qcom,cam-vreg-min-voltage = <0x0 0x2ab980 0x2b7cd0>;
				qcom,cam-vreg-name = "cam_vio", "cam_vana", "cam_vaf";
				qcom,cam-vreg-op-mode = <0x0 0x13880 0x186a0>;
				qcom,cci-master = <0x0>;
				qcom,clock-rates = <0x16e3600 0x0>;
				qcom,csid-sd-index = <0x1>;
				qcom,csiphy-sd-index = <0x1>;
				qcom,eeprom-src = <0x4>;
				qcom,gpio-no-mux = <0x0>;
				qcom,gpio-req-tbl-flags = <0x1 0x0 0x0>;
				qcom,gpio-req-tbl-label = "CAM_VDIG", "CAMIF_MCLK2", "CAM_RESET2";
				qcom,gpio-req-tbl-num = <0x0 0x1 0x2>;
				qcom,gpio-reset = <0x2>;
				qcom,gpio-vdig = <0x0>;
				qcom,mount-angle = <0x10e>;
				qcom,sensor-mode = <0x0>;
				qcom,sensor-position = <0x1>;
				reg = <0x1>;
			};

			qcom,eeprom@0 {
				cam_vaf-supply = <0xffffffff>;
				cam_vana-supply = <0xffffffff>;
				cam_vio-supply = <0xffffffff>;
				cell-index = <0x0>;
				clock-names = "cam_src_clk", "cam_clk";
				clocks = <0xffffffff 0x266b3853 0xffffffff 0x80902deb>;
				compatible = "qcom,eeprom";
				gpios = <0xffffffff 0x19 0x0 0xffffffff 0x1a 0x0 0xffffffff 0x24 0x0>;
				phandle = <0x3>;
				pinctrl-0 = <0xffffffff 0xffffffff 0xffffffff>;
				pinctrl-1 = <0xffffffff 0xffffffff 0xffffffff>;
				pinctrl-names = "cam_default", "cam_suspend";
				qcom,cam-vreg-max-voltage = <0x0 0x2ab980 0x2b7cd0>;
				qcom,cam-vreg-min-voltage = <0x0 0x2ab980 0x2b7cd0>;
				qcom,cam-vreg-name = "cam_vio", "cam_vana", "cam_vaf";
				qcom,cam-vreg-op-mode = <0x0 0x13880 0x186a0>;
				qcom,cci-master = <0x0>;
				qcom,clock-rates = <0x124f800 0x0>;
				qcom,gpio-req-tbl-flags = <0x0 0x1 0x0>;
				qcom,gpio-req-tbl-label = "CAM_VDIG", "CAMIF_MCLK0", "CAM_RESET0";
				qcom,gpio-req-tbl-num = <0x0 0x1 0x2>;
				qcom,gpio-reset = <0x2>;
				qcom,gpio-vdig = <0x0>;
				reg = <0x0>;
				status = "ok";
			};

			qcom,eeprom@2 {
				cam_vaf-supply = <0xffffffff>;
				cam_vana-supply = <0xffffffff>;
				cam_vio-supply = <0xffffffff>;
				cell-index = <0x2>;
				clock-names = "cam_src_clk", "cam_clk";
				clocks = <0xffffffff 0x42545468 0xffffffff 0x222f8fff>;
				compatible = "qcom,eeprom";
				gpios = <0xffffffff 0x19 0x0 0xffffffff 0x1c 0x0 0xffffffff 0x28 0x0>;
				phandle = <0x4>;
				pinctrl-0 = <0xffffffff 0xffffffff 0xffffffff>;
				pinctrl-1 = <0xffffffff 0xffffffff 0xffffffff>;
				pinctrl-names = "cam_default", "cam_suspend";
				qcom,cam-vreg-max-voltage = <0x0 0x2ab980 0x2b7cd0>;
				qcom,cam-vreg-min-voltage = <0x0 0x2ab980 0x2b7cd0>;
				qcom,cam-vreg-name = "cam_vio", "cam_vana", "cam_vaf";
				qcom,cam-vreg-op-mode = <0x0 0x13880 0x186a0>;
				qcom,cci-master = <0x0>;
				qcom,clock-rates = <0x124f800 0x0>;
				qcom,gpio-no-mux = <0x0>;
				qcom,gpio-req-tbl-flags = <0x1 0x0 0x0>;
				qcom,gpio-req-tbl-label = "CAM_VDIG", "CAMIF_MCLK2", "CAM_RESET2", "CAM_STANDBY2";
				qcom,gpio-req-tbl-num = <0x0 0x1 0x2>;
				qcom,gpio-reset = <0x2>;
				qcom,gpio-standby = <0x0>;
				reg = <0x2>;
				status = "ok";
			};
		};
	};

	fragment@10 {
		target = <0xffffffff>;

		__overlay__ {

			qcom,mdss_dsi_sim_video {
				phandle = <0x8>;
				qcom,mdss-dsi-bllp-eof-power-mode;
				qcom,mdss-dsi-bllp-power-mode;
				qcom,mdss-dsi-border-color = <0x0>;
				qcom,mdss-dsi-bpp = <0x18>;
				qcom,mdss-dsi-dma-trigger = "trigger_sw";
				qcom,mdss-dsi-lane-0-state;
				qcom,mdss-dsi-lane-1-state;
				qcom,mdss-dsi-lane-2-state;
				qcom,mdss-dsi-lane-3-state;
				qcom,mdss-dsi-mdp-trigger = "none";
				qcom,mdss-dsi-panel-blackness-level = <0xc9e>;
				qcom,mdss-dsi-panel-hdr-color-primaries = <0x38a4 0x3c8c 0x7d00 0x4268 0x3c8c 0x7530 0x1f40 0xbb8>;
				qcom,mdss-dsi-panel-hdr-enabled;
				qcom,mdss-dsi-panel-name = "Simulator video mode dsi panel";
				qcom,mdss-dsi-panel-peak-brightness = <0x401640>;
				qcom,mdss-dsi-panel-type = "dsi_video_mode";
				qcom,mdss-dsi-reset-sequence = <0x1 0x0 0x0 0x0 0x1 0x0>;
				qcom,mdss-dsi-stream = <0x0>;
				qcom,mdss-dsi-t-clk-post = <0x4>;
				qcom,mdss-dsi-t-clk-pre = <0x1b>;
				qcom,mdss-dsi-traffic-mode = "non_burst_sync_event";
				qcom,mdss-dsi-underflow-color = <0xff>;
				qcom,mdss-dsi-virtual-channel-id = <0x0>;
				qcom,panel-ack-disabled;

				qcom,mdss-dsi-display-timings {

					timing@0 {
						qcom,mdss-dsi-h-back-porch = <0x8>;
						qcom,mdss-dsi-h-front-porch = <0x8>;
						qcom,mdss-dsi-h-left-border = <0x0>;
						qcom,mdss-dsi-h-pulse-width = <0x8>;
						qcom,mdss-dsi-h-right-border = <0x0>;
						qcom,mdss-dsi-h-sync-pulse = <0x0>;
						qcom,mdss-dsi-h-sync-skew = <0x0>;
						qcom,mdss-dsi-off-command = [22 01 00 00 00 00 02 00 00];
						qcom,mdss-dsi-off-command-state = "dsi_lp_mode";
						qcom,mdss-dsi-on-command = [32 01 00 00 00 00 02 00 00];
						qcom,mdss-dsi-on-command-state = "dsi_lp_mode";
						qcom,mdss-dsi-panel-framerate = <0x3c>;
						qcom,mdss-dsi-panel-height = <0x1e0>;
						qcom,mdss-dsi-panel-timings = <0x0 0x0 0x0>;
						qcom,mdss-dsi-panel-width = <0x280>;
						qcom,mdss-dsi-v-back-porch = <0x6>;
						qcom,mdss-dsi-v-bottom-border = <0x0>;
						qcom,mdss-dsi-v-front-porch = <0x6>;
						qcom,mdss-dsi-v-pulse-width = <0x2>;
						qcom,mdss-dsi-v-top-border = <0x0>;
					};
				};
			};
		};
	};

	fragment@11 {
		target = <0xffffffff>;

		__overlay__ {

			qcom,mdss_dsi_sim_cmd {
				phandle = <0x9>;
				qcom,mdss-dsi-bl-max-level = <0xfff>;
				qcom,mdss-dsi-bllp-eof-power-mode;
				qcom,mdss-dsi-bllp-power-mode;
				qcom,mdss-dsi-border-color = <0x0>;
				qcom,mdss-dsi-bpp = <0x18>;
				qcom,mdss-dsi-color-order = "rgb_swap_rgb";
				qcom,mdss-dsi-dma-trigger = "trigger_sw";
				qcom,mdss-dsi-lane-0-state;
				qcom,mdss-dsi-lane-1-state;
				qcom,mdss-dsi-lane-2-state;
				qcom,mdss-dsi-lane-3-state;
				qcom,mdss-dsi-mdp-trigger = "none";
				qcom,mdss-dsi-panel-blackness-level = <0xc9e>;
				qcom,mdss-dsi-panel-hdr-color-primaries = <0x38a4 0x3c8c 0x7d00 0x4268 0x3c8c 0x7530 0x1f40 0xbb8>;
				qcom,mdss-dsi-panel-hdr-enabled;
				qcom,mdss-dsi-panel-name = "Simulator cmd mode dsi panel";
				qcom,mdss-dsi-panel-peak-brightness = <0x401640>;
				qcom,mdss-dsi-panel-type = "dsi_cmd_mode";
				qcom,mdss-dsi-reset-sequence = <0x1 0xa 0x0 0xa 0x1 0xa>;
				qcom,mdss-dsi-stream = <0x0>;
				qcom,mdss-dsi-t-clk-post = <0x3>;
				qcom,mdss-dsi-t-clk-pre = <0x27>;
				qcom,mdss-dsi-te-check-enable;
				qcom,mdss-dsi-te-dcs-command = <0x1>;
				qcom,mdss-dsi-te-pin-select = <0x1>;
				qcom,mdss-dsi-te-using-te-pin;
				qcom,mdss-dsi-te-using-wd;
				qcom,mdss-dsi-traffic-mode = "non_burst_sync_event";
				qcom,mdss-dsi-underflow-color = <0xff>;
				qcom,mdss-dsi-virtual-channel-id = <0x0>;
				qcom,mdss-dsi-wr-mem-continue = <0x3c>;
				qcom,mdss-dsi-wr-mem-start = <0x2c>;
				qcom,panel-ack-disabled;
				qcom,ulps-enabled;

				qcom,mdss-dsi-display-timings {

					timing@0 {
						qcom,compression-mode = "dsc";
						qcom,mdss-dsc-bit-per-component = <0x8>;
						qcom,mdss-dsc-bit-per-pixel = <0x8>;
						qcom,mdss-dsc-block-prediction-enable;
						qcom,mdss-dsc-slice-height = <0x28>;
						qcom,mdss-dsc-slice-per-pkt = <0x1>;
						qcom,mdss-dsc-slice-width = <0x2d0>;
						qcom,mdss-dsi-h-back-porch = <0x64>;
						qcom,mdss-dsi-h-front-porch = <0x78>;
						qcom,mdss-dsi-h-left-border = <0x0>;
						qcom,mdss-dsi-h-pulse-width = <0x28>;
						qcom,mdss-dsi-h-right-border = <0x0>;
						qcom,mdss-dsi-h-sync-skew = <0x0>;
						qcom,mdss-dsi-off-command = [05 01 00 00 32 00 02 28 00 05 01 00 00 78 00 02 10 00];
						qcom,mdss-dsi-off-command-state = "dsi_hs_mode";
						qcom,mdss-dsi-on-command = <0x29010000 0x2b0 0x3050100 0xa0001 0x150100 0xa0002 0x3a773901 0xa00 0x52a0000 0x4ff3901 0xa00 0x52b0000 0x59f1501 0xa00 0x2350039 0x100000a 0x34400 0x150100 0xa0002 0x51ff1501 0xa00 0x2532415 0x100000a 0x25500 0x5010000 0x78000111 0x5010000 0x10000129>;
						qcom,mdss-dsi-on-command-state = "dsi_lp_mode";
						qcom,mdss-dsi-panel-framerate = <0x3c>;
						qcom,mdss-dsi-panel-height = <0xa00>;
						qcom,mdss-dsi-panel-timings = <0x210909 0x24230808 0x8030400>;
						qcom,mdss-dsi-panel-width = <0x5a0>;
						qcom,mdss-dsi-v-back-porch = <0x64>;
						qcom,mdss-dsi-v-bottom-border = <0x0>;
						qcom,mdss-dsi-v-front-porch = <0x64>;
						qcom,mdss-dsi-v-pulse-width = <0x28>;
						qcom,mdss-dsi-v-top-border = <0x0>;
					};

					timing@1 {
						qcom,compression-mode = "dsc";
						qcom,mdss-dsc-bit-per-component = <0x8>;
						qcom,mdss-dsc-bit-per-pixel = <0x8>;
						qcom,mdss-dsc-block-prediction-enable;
						qcom,mdss-dsc-slice-height = <0x28>;
						qcom,mdss-dsc-slice-per-pkt = <0x1>;
						qcom,mdss-dsc-slice-width = <0x21c>;
						qcom,mdss-dsi-h-back-porch = <0x1cc>;
						qcom,mdss-dsi-h-front-porch = <0x78>;
						qcom,mdss-dsi-h-left-border = <0x0>;
						qcom,mdss-dsi-h-pulse-width = <0x28>;
						qcom,mdss-dsi-h-right-border = <0x0>;
						qcom,mdss-dsi-h-sync-skew = <0x0>;
						qcom,mdss-dsi-off-command = [05 01 00 00 32 00 02 28 00 05 01 00 00 78 00 02 10 00];
						qcom,mdss-dsi-off-command-state = "dsi_hs_mode";
						qcom,mdss-dsi-on-command = <0x29010000 0x2b0 0x3050100 0xa0001 0x150100 0xa0002 0x3a773901 0xa00 0x52a0000 0x4ff3901 0xa00 0x52b0000 0x59f1501 0xa00 0x2350039 0x100000a 0x34400 0x150100 0xa0002 0x51ff1501 0xa00 0x2532415 0x100000a 0x25500 0x5010000 0x78000111 0x5010000 0x10000129>;
						qcom,mdss-dsi-on-command-state = "dsi_lp_mode";
						qcom,mdss-dsi-panel-framerate = <0x3c>;
						qcom,mdss-dsi-panel-height = <0x780>;
						qcom,mdss-dsi-panel-timings = <0x210909 0x24230808 0x8030400>;
						qcom,mdss-dsi-panel-width = <0x438>;
						qcom,mdss-dsi-v-back-porch = <0x64>;
						qcom,mdss-dsi-v-bottom-border = <0x0>;
						qcom,mdss-dsi-v-front-porch = <0x2e4>;
						qcom,mdss-dsi-v-pulse-width = <0x28>;
						qcom,mdss-dsi-v-top-border = <0x0>;
					};

					timing@2 {
						qcom,compression-mode = "dsc";
						qcom,mdss-dsc-bit-per-component = <0x8>;
						qcom,mdss-dsc-bit-per-pixel = <0x8>;
						qcom,mdss-dsc-block-prediction-enable;
						qcom,mdss-dsc-slice-height = <0x28>;
						qcom,mdss-dsc-slice-per-pkt = <0x1>;
						qcom,mdss-dsc-slice-width = <0x168>;
						qcom,mdss-dsi-h-back-porch = <0x348>;
						qcom,mdss-dsi-h-front-porch = <0x64>;
						qcom,mdss-dsi-h-left-border = <0x0>;
						qcom,mdss-dsi-h-pulse-width = <0x28>;
						qcom,mdss-dsi-h-right-border = <0x0>;
						qcom,mdss-dsi-h-sync-skew = <0x0>;
						qcom,mdss-dsi-off-command = [05 01 00 00 32 00 02 28 00 05 01 00 00 78 00 02 10 00];
						qcom,mdss-dsi-off-command-state = "dsi_hs_mode";
						qcom,mdss-dsi-on-command = <0x29010000 0x2b0 0x3050100 0xa0001 0x150100 0xa0002 0x3a773901 0xa00 0x52a0000 0x4ff3901 0xa00 0x52b0000 0x59f1501 0xa00 0x2350039 0x100000a 0x34400 0x150100 0xa0002 0x51ff1501 0xa00 0x2532415 0x100000a 0x25500 0x5010000 0x78000111 0x5010000 0x10000129>;
						qcom,mdss-dsi-on-command-state = "dsi_lp_mode";
						qcom,mdss-dsi-panel-framerate = <0x3c>;
						qcom,mdss-dsi-panel-height = <0x500>;
						qcom,mdss-dsi-panel-timings = <0x210909 0x24230808 0x8030400>;
						qcom,mdss-dsi-panel-width = <0x2d0>;
						qcom,mdss-dsi-v-back-porch = <0x64>;
						qcom,mdss-dsi-v-bottom-border = <0x0>;
						qcom,mdss-dsi-v-front-porch = <0x564>;
						qcom,mdss-dsi-v-pulse-width = <0x28>;
						qcom,mdss-dsi-v-top-border = <0x0>;
					};
				};
			};
		};
	};

	fragment@12 {
		target = <0xffffffff>;

		__overlay__ {

			qcom,mdss_dsi_truly_1080p_video {
				phandle = <0xa>;
				qcom,mdss-dsi-bl-max-level = <0xfff>;
				qcom,mdss-dsi-bl-min-level = <0x1>;
				qcom,mdss-dsi-bl-pmic-control-type = "bl_ctrl_wled";
				qcom,mdss-dsi-bllp-eof-power-mode;
				qcom,mdss-dsi-bllp-power-mode;
				qcom,mdss-dsi-border-color = <0x0>;
				qcom,mdss-dsi-bpp = <0x18>;
				qcom,mdss-dsi-dma-trigger = "trigger_sw";
				qcom,mdss-dsi-h-back-porch = <0x40>;
				qcom,mdss-dsi-h-front-porch = <0x60>;
				qcom,mdss-dsi-h-left-border = <0x0>;
				qcom,mdss-dsi-h-pulse-width = <0x10>;
				qcom,mdss-dsi-h-right-border = <0x0>;
				qcom,mdss-dsi-h-sync-pulse = <0x0>;
				qcom,mdss-dsi-h-sync-skew = <0x0>;
				qcom,mdss-dsi-lane-0-state;
				qcom,mdss-dsi-lane-1-state;
				qcom,mdss-dsi-lane-2-state;
				qcom,mdss-dsi-lane-3-state;
				qcom,mdss-dsi-mdp-trigger = "none";
				qcom,mdss-dsi-off-command = [05 01 00 00 14 00 02 28 00 05 01 00 00 78 00 02 10 00];
				qcom,mdss-dsi-off-command-state = "dsi_lp_mode";
				qcom,mdss-dsi-on-command = [15 01 00 00 00 00 02 35 00 15 01 00 00 00 00 02 51 ff 15 01 00 00 00 00 02 53 2c 15 01 00 00 00 00 02 55 00 05 01 00 00 78 00 02 11 00 23 01 00 00 00 00 02 b0 00 29 01 00 00 00 00 07 b3 14 00 00 00 00 00 29 01 00 00 00 00 03 b6 3a d3 29 01 00 00 00 00 03 c0 00 00 29 01 00 00 00 00 23 c1 84 60 10 eb ff 6f ce ff ff 17 02 58 73 ae b1 20 c6 ff ff 1f f3 ff 5f 10 10 10 10 00 02 01 22 22 00 01 29 01 00 00 00 00 08 c2 31 f7 80 06 08 00 00 29 01 00 00 00 00 17 c4 70 00 00 00 00 04 00 00 00 0c 06 00 00 00 00 00 04 00 00 00 0c 06 29 01 00 00 00 00 29 c6 00 69 00 69 00 69 00 00 00 00 00 69 00 69 00 69 10 19 07 00 01 00 69 00 69 00 69 00 00 00 00 00 69 00 69 00 69 10 19 07 29 01 00 00 00 00 0a cb 31 fc 3f 8c 00 00 00 00 c0 23 01 00 00 00 00 02 cc 0b 29 01 00 00 00 00 0b d0 11 81 bb 1e 1e 4c 19 19 0c 00 29 01 00 00 00 00 1a d3 1b 33 bb bb b3 33 33 33 00 01 00 a0 d8 a0 0d 4e 4e 33 3b 22 72 07 3d bf 33 29 01 00 00 00 00 08 d5 06 00 00 01 51 01 32 29 01 00 00 00 00 1f c7 01 0a 11 18 26 33 3e 50 38 42 52 60 67 6e 77 01 0a 11 18 26 33 3e 50 38 42 52 60 67 6e 77 29 01 00 00 14 00 14 c8 01 00 00 00 00 fc 00 00 00 00 00 fc 00 00 00 00 00 fc 00 05 01 00 00 14 00 02 29 00];
				qcom,mdss-dsi-on-command-state = "dsi_lp_mode";
				qcom,mdss-dsi-panel-framerate = <0x3c>;
				qcom,mdss-dsi-panel-height = <0x780>;
				qcom,mdss-dsi-panel-name = "truly 1080p video mode dsi panel";
				qcom,mdss-dsi-panel-timings = <0xe6382600 0x686e2a3c 0x44030400>;
				qcom,mdss-dsi-panel-type = "dsi_video_mode";
				qcom,mdss-dsi-panel-width = <0x438>;
				qcom,mdss-dsi-post-init-delay = <0x1>;
				qcom,mdss-dsi-reset-sequence = <0x1 0xa 0x0 0xa 0x1 0xa>;
				qcom,mdss-dsi-stream = <0x0>;
				qcom,mdss-dsi-t-clk-post = <0x2>;
				qcom,mdss-dsi-t-clk-pre = <0x2d>;
				qcom,mdss-dsi-traffic-mode = "burst_mode";
				qcom,mdss-dsi-tx-eot-append;
				qcom,mdss-dsi-underflow-color = <0xff>;
				qcom,mdss-dsi-v-back-porch = <0x10>;
				qcom,mdss-dsi-v-bottom-border = <0x0>;
				qcom,mdss-dsi-v-front-porch = <0x4>;
				qcom,mdss-dsi-v-pulse-width = <0x1>;
				qcom,mdss-dsi-v-top-border = <0x0>;
				qcom,mdss-dsi-virtual-channel-id = <0x0>;
			};
		};
	};

	fragment@13 {
		target = <0xffffffff>;

		__overlay__ {

			qcom,mdss_dsi_truly_1080p_cmd {
				phandle = <0xb>;
				qcom,mdss-dsi-bl-max-level = <0xfff>;
				qcom,mdss-dsi-bl-min-level = <0x1>;
				qcom,mdss-dsi-bl-pmic-control-type = "bl_ctrl_wled";
				qcom,mdss-dsi-bllp-eof-power-mode;
				qcom,mdss-dsi-bllp-power-mode;
				qcom,mdss-dsi-border-color = <0x0>;
				qcom,mdss-dsi-bpp = <0x18>;
				qcom,mdss-dsi-dma-trigger = "trigger_sw";
				qcom,mdss-dsi-h-back-porch = <0x40>;
				qcom,mdss-dsi-h-front-porch = <0x60>;
				qcom,mdss-dsi-h-left-border = <0x0>;
				qcom,mdss-dsi-h-pulse-width = <0x10>;
				qcom,mdss-dsi-h-right-border = <0x0>;
				qcom,mdss-dsi-h-sync-pulse = <0x0>;
				qcom,mdss-dsi-h-sync-skew = <0x0>;
				qcom,mdss-dsi-lane-0-state;
				qcom,mdss-dsi-lane-1-state;
				qcom,mdss-dsi-lane-2-state;
				qcom,mdss-dsi-lane-3-state;
				qcom,mdss-dsi-mdp-trigger = "none";
				qcom,mdss-dsi-off-command = [05 01 00 00 14 00 02 28 00 05 01 00 00 78 00 02 10 00];
				qcom,mdss-dsi-off-command-state = "dsi_lp_mode";
				qcom,mdss-dsi-on-command = [23 01 00 00 00 00 02 d6 01 15 01 00 00 00 00 02 35 00 15 01 00 00 00 00 02 51 ff 15 01 00 00 00 00 02 53 2c 15 01 00 00 00 00 02 55 00 05 01 00 00 78 00 02 11 00 23 01 00 00 00 00 02 b0 04 29 01 00 00 00 00 07 b3 04 00 00 00 00 00 29 01 00 00 00 00 03 b6 3a d3 29 01 00 00 00 00 03 c0 00 00 29 01 00 00 00 00 23 c1 84 60 10 eb ff 6f ce ff ff 17 02 58 73 ae b1 20 c6 ff ff 1f f3 ff 5f 10 10 10 10 00 02 01 22 22 00 01 29 01 00 00 00 00 08 c2 31 f7 80 06 08 00 00 29 01 00 00 00 00 17 c4 70 00 00 00 00 04 00 00 00 0c 06 00 00 00 00 00 04 00 00 00 0c 06 29 01 00 00 00 00 29 c6 78 69 00 69 00 69 00 00 00 00 00 69 00 69 00 69 10 19 07 00 78 00 69 00 69 00 69 00 00 00 00 00 69 00 69 00 69 10 19 07 29 01 00 00 00 00 0a cb 31 fc 3f 8c 00 00 00 00 c0 23 01 00 00 00 00 02 cc 0b 29 01 00 00 00 00 0b d0 11 81 bb 1e 1e 4c 19 19 0c 00 29 01 00 00 00 00 1a d3 1b 33 bb bb b3 33 33 33 00 01 00 a0 d8 a0 0d 4e 4e 33 3b 22 72 07 3d bf 33 29 01 00 00 00 00 08 d5 06 00 00 01 51 01 32 29 01 00 00 00 00 1f c7 01 0a 11 18 26 33 3e 50 38 42 52 60 67 6e 77 01 0a 11 18 26 33 3e 50 38 42 52 60 67 6e 77 29 01 00 00 14 00 14 c8 01 00 00 00 00 fc 00 00 00 00 00 fc 00 00 00 00 00 fc 00 05 01 00 00 14 00 02 29 00];
				qcom,mdss-dsi-on-command-state = "dsi_lp_mode";
				qcom,mdss-dsi-panel-framerate = <0x3c>;
				qcom,mdss-dsi-panel-height = <0x780>;
				qcom,mdss-dsi-panel-name = "truly 1080p cmd mode dsi panel";
				qcom,mdss-dsi-panel-timings = <0xe6382600 0x686e2a3c 0x44030400>;
				qcom,mdss-dsi-panel-type = "dsi_cmd_mode";
				qcom,mdss-dsi-panel-width = <0x438>;
				qcom,mdss-dsi-post-init-delay = <0x1>;
				qcom,mdss-dsi-reset-sequence = <0x1 0xa 0x0 0xa 0x1 0xa>;
				qcom,mdss-dsi-stream = <0x0>;
				qcom,mdss-dsi-t-clk-post = <0x2>;
				qcom,mdss-dsi-t-clk-pre = <0x2d>;
				qcom,mdss-dsi-te-check-enable;
				qcom,mdss-dsi-te-dcs-command = <0x1>;
				qcom,mdss-dsi-te-pin-select = <0x1>;
				qcom,mdss-dsi-te-using-te-pin;
				qcom,mdss-dsi-traffic-mode = "burst_mode";
				qcom,mdss-dsi-tx-eot-append;
				qcom,mdss-dsi-underflow-color = <0xff>;
				qcom,mdss-dsi-v-back-porch = <0x10>;
				qcom,mdss-dsi-v-bottom-border = <0x0>;
				qcom,mdss-dsi-v-front-porch = <0x4>;
				qcom,mdss-dsi-v-pulse-width = <0x1>;
				qcom,mdss-dsi-v-top-border = <0x0>;
				qcom,mdss-dsi-virtual-channel-id = <0x0>;
			};
		};
	};

	fragment@14 {
		target = <0xffffffff>;

		__overlay__ {

			qcom,mdss_dsi_truly_720p_video {
				phandle = <0xc>;
				qcom,mdss-dsi-bl-max-level = <0xfff>;
				qcom,mdss-dsi-bl-min-level = <0x1>;
				qcom,mdss-dsi-bl-pmic-control-type = "bl_ctrl_wled";
				qcom,mdss-dsi-bllp-eof-power-mode;
				qcom,mdss-dsi-bllp-power-mode;
				qcom,mdss-dsi-border-color = <0x0>;
				qcom,mdss-dsi-bpp = <0x18>;
				qcom,mdss-dsi-dma-trigger = "trigger_sw";
				qcom,mdss-dsi-h-back-porch = <0x64>;
				qcom,mdss-dsi-h-front-porch = <0x64>;
				qcom,mdss-dsi-h-left-border = <0x0>;
				qcom,mdss-dsi-h-pulse-width = <0x6>;
				qcom,mdss-dsi-h-right-border = <0x0>;
				qcom,mdss-dsi-h-sync-pulse = <0x0>;
				qcom,mdss-dsi-h-sync-skew = <0x0>;
				qcom,mdss-dsi-lane-0-state;
				qcom,mdss-dsi-lane-1-state;
				qcom,mdss-dsi-lane-2-state;
				qcom,mdss-dsi-lane-3-state;
				qcom,mdss-dsi-lp11-init;
				qcom,mdss-dsi-mdp-trigger = "none";
				qcom,mdss-dsi-off-command = [05 01 00 00 14 00 02 28 00 05 01 00 00 78 00 02 10 00];
				qcom,mdss-dsi-off-command-state = "dsi_lp_mode";
				qcom,mdss-dsi-on-command = <0x29010000 0x6f0 0x55aa5208 0x290100 0x3 0xb1782123 0x1000000 0x2b60f 0x29010000 0x3bc 0x2901 0x0 0x6bd02b0 0x1e1e0029 0x1000000 0xbe7f2 0xe6d8ccbf 0xb2a59999 0x95290100 0xb 0xe8f2e6d8 0xccbfb2a5 0x99999529 0x1000000 0x6f055 0xaa520801 0x29010000 0x3bc 0xa0002901 0x0 0x3bda000 0x23010000 0x2ca 0x1230100 0x2 0xc00c2301 0x0 0x2be4e29 0x1000000 0x3b338 0x38290100 0x3 0xb4111129 0x1000000 0x3b605 0x5290100 0x3 0xb9454529 0x1000000 0x3ba25 0x25290100 0x3 0xc4111123 0x1000000 0x2c666 0x29010000 0x6f0 0x55aa5208 0x2230100 0x2 0xee002901 0x0 0x11b00037 0x480069 0x8a00ab 0xcb00eb 0x11c2901 0x0 0x11b10141 0x17c01aa 0x1f3022d 0x22e0263 0x29d2901 0x0 0x11b202c3 0x2f60319 0x3540385 0x3b203c1 0x3d12901 0x0 0x5b303e0 0x3e82901 0x0 0x11bc0037 0x480069 0x8a00ab 0xcb00eb 0x11c2901 0x0 0x11bd0141 0x17c01aa 0x1f3022d 0x22e0263 0x29d2901 0x0 0x11be02c3 0x2f60319 0x3540385 0x3b203c1 0x3d12901 0x0 0x5bf03e0 0x3e82901 0x0 0x11b400d1 0xd700e4 0xf100fe 0x1120126 0x1482901 0x0 0x11b50164 0x19501bd 0x2010236 0x238026c 0x2a72901 0x0 0x11b602ce 0x304032b 0x35b0389 0x3b203c1 0x3d12901 0x0 0x5b703e0 0x3e82901 0x0 0x11c000d1 0xd700e4 0xf100fe 0x1120126 0x1482901 0x0 0x11c10164 0x19501bd 0x2010236 0x238026c 0x2a72901 0x0 0x11c202ce 0x304032b 0x35b0389 0x3b203c1 0x3d12901 0x0 0x5c303e0 0x3e82901 0x0 0x11b80037 0x450061 0x7d009a 0xbb00dc 0x10b2901 0x0 0x11b90131 0x16e019e 0x1ea0224 0x2250258 0x2902901 0x0 0x11ba02b4 0x2e40304 0x344037f 0x3b203c1 0x3d12901 0x0 0x5bb03e0 0x3e82901 0x0 0x11c40037 0x450061 0x7d009a 0xbb00dc 0x10b2901 0x0 0x11c50131 0x16e019e 0x1ea0224 0x2250258 0x2902901 0x0 0x11c602b4 0x2e40304 0x344037f 0x3b203c1 0x3d12901 0x0 0x5c703e0 0x3e82901 0x0 0x6f055aa 0x52080629 0x1000000 0x3b029 0x2a290100 0x3 0xb1101229 0x1000000 0x3b214 0x16290100 0x3 0xb3181a29 0x1000000 0x3b402 0x4290100 0x3 0xb5343429 0x1000000 0x3b634 0x2e290100 0x3 0xb72e2e29 0x1000000 0x3b834 0x290100 0x3 0xb9343429 0x1000000 0x3ba34 0x34290100 0x3 0xbb013429 0x1000000 0x3bc2e 0x2e290100 0x3 0xbd2e3429 0x1000000 0x3be34 0x34290100 0x3 0xbf050329 0x1000000 0x3c01b 0x19290100 0x3 0xc1171529 0x1000000 0x3c213 0x11290100 0x3 0xc32a2929 0x1000000 0x3e52e 0x2e290100 0x3 0xc4292a29 0x1000000 0x3c51b 0x19290100 0x3 0xc6171529 0x1000000 0x3c713 0x11290100 0x3 0xc8010529 0x1000000 0x3c934 0x34290100 0x3 0xca342e29 0x1000000 0x3cb2e 0x2e290100 0x3 0xcc340329 0x1000000 0x3cd34 0x34290100 0x3 0xce343429 0x1000000 0x3cf02 0x34290100 0x3 0xd02e2e29 0x1000000 0x3d12e 0x34290100 0x3 0xd2343429 0x1000000 0x3d304 0x290100 0x3 0xd4101229 0x1000000 0x3d514 0x16290100 0x3 0xd6181a29 0x1000000 0x3d72a 0x29290100 0x3 0xe62e2e29 0x1000000 0x6d800 0x5400 0x29010000 0x6d9 0x150000 0x230100 0x2 0xe7002901 0x0 0x6f055aa 0x52080329 0x1000000 0x3b100 0x290100 0x3 0xb0000029 0x1000000 0x6b205 0x0 0x29010000 0x6b3 0x5000000 0x290100 0x6 0xb4050000 0x2901 0x0 0x6b50500 0x17000029 0x1000000 0x6b612 0x190000 0x29010000 0x6b7 0x12001900 0x290100 0x6 0xb8120019 0x2901 0x0 0x6b91200 0x19000029 0x1000000 0x6ba57 0x0 0x29010000 0x6bb 0x57000000 0x290100 0x6 0xbc75001a 0x2901 0x0 0x6bd5300 0x1a000029 0x1000000 0x5c000 0x34000029 0x1000000 0x5c100 0x34000029 0x1000000 0x5c200 0x34000029 0x1000000 0x5c300 0x34000023 0x1000000 0x2c420 0x23010000 0x2c5 0x230100 0x2 0xc6002301 0x0 0x2c70029 0x1000000 0x6f055 0xaa520805 0x23010000 0x2ed 0x30290100 0x3 0xb0170623 0x1000000 0x2b808 0x29010000 0x6bd 0x3070003 0x290100 0x3 0xb1170623 0x1000000 0x2b900 0x29010000 0x3b2 0x2301 0x0 0x2ba0029 0x1000000 0x3b317 0x6230100 0x2 0xbb0a2901 0x0 0x3b41706 0x29010000 0x3b5 0x17062901 0x0 0x3b61403 0x29010000 0x3b7 0x2301 0x0 0x2bc0223 0x1000000 0x2e506 0x23010000 0x2e6 0x6230100 0x2 0xe7002301 0x0 0x2e80623 0x1000000 0x2e906 0x23010000 0x2ea 0x6230100 0x2 0xeb002301 0x0 0x2ec0023 0x1000000 0x2c007 0x23010000 0x2c1 0x80230100 0x2 0xc2a42301 0x0 0x2c30523 0x1000000 0x2c400 0x23010000 0x2c5 0x2230100 0x2 0xc6222301 0x0 0x2c70329 0x1000000 0x3c805 0x30290100 0x3 0xc9013129 0x1000000 0x3ca03 0x21290100 0x3 0xcb012029 0x1000000 0x6d100 0x5090710 0x29010000 0x6d2 0x10050e03 0x10290100 0x6 0xd3200048 0x7102901 0x0 0x6d43000 0x43071023 0x1000000 0x2d000 0x29010000 0x4cc 0x3e29 0x1000000 0x4cd00 0x3e2901 0x0 0x4ce0000 0x2290100 0x4 0xcf000002 0x23010000 0x26f 0x11230100 0x2 0xf3011501 0x0 0x251ff15 0x1000000 0x2532c 0x15010000 0x255 0x3150100 0xc80002 0x35000501 0x7800 0x2110005 0x100000a 0x22900>;
				qcom,mdss-dsi-on-command-state = "dsi_lp_mode";
				qcom,mdss-dsi-panel-framerate = <0x3c>;
				qcom,mdss-dsi-panel-height = <0x500>;
				qcom,mdss-dsi-panel-name = "truly 720p video mode dsi panel";
				qcom,mdss-dsi-panel-timings = <0x872c1200 0x4044161e 0x17030400>;
				qcom,mdss-dsi-panel-type = "dsi_video_mode";
				qcom,mdss-dsi-panel-width = <0x2d0>;
				qcom,mdss-dsi-post-init-delay = <0x1>;
				qcom,mdss-dsi-reset-sequence = <0x1 0xa 0x0 0xa 0x1 0xa>;
				qcom,mdss-dsi-stream = <0x0>;
				qcom,mdss-dsi-t-clk-post = <0x4>;
				qcom,mdss-dsi-t-clk-pre = <0x1b>;
				qcom,mdss-dsi-traffic-mode = "burst_mode";
				qcom,mdss-dsi-tx-eot-append;
				qcom,mdss-dsi-underflow-color = <0xff>;
				qcom,mdss-dsi-v-back-porch = <0x20>;
				qcom,mdss-dsi-v-bottom-border = <0x0>;
				qcom,mdss-dsi-v-front-porch = <0x20>;
				qcom,mdss-dsi-v-pulse-width = <0x2>;
				qcom,mdss-dsi-v-top-border = <0x0>;
				qcom,mdss-dsi-virtual-channel-id = <0x0>;
			};
		};
	};

	fragment@15 {
		target = <0xffffffff>;

		__overlay__ {

			qcom,mdss_dsi_truly_720p_cmd {
				phandle = <0xd>;
				qcom,mdss-dsi-bl-max-level = <0xfff>;
				qcom,mdss-dsi-bl-min-level = <0x1>;
				qcom,mdss-dsi-bl-pmic-control-type = "bl_ctrl_wled";
				qcom,mdss-dsi-bllp-eof-power-mode;
				qcom,mdss-dsi-bllp-power-mode;
				qcom,mdss-dsi-border-color = <0x0>;
				qcom,mdss-dsi-bpp = <0x18>;
				qcom,mdss-dsi-dma-trigger = "trigger_sw";
				qcom,mdss-dsi-h-back-porch = <0x64>;
				qcom,mdss-dsi-h-front-porch = <0x64>;
				qcom,mdss-dsi-h-left-border = <0x0>;
				qcom,mdss-dsi-h-pulse-width = <0x6>;
				qcom,mdss-dsi-h-right-border = <0x0>;
				qcom,mdss-dsi-h-sync-pulse = <0x0>;
				qcom,mdss-dsi-h-sync-skew = <0x0>;
				qcom,mdss-dsi-lane-0-state;
				qcom,mdss-dsi-lane-1-state;
				qcom,mdss-dsi-lane-2-state;
				qcom,mdss-dsi-lane-3-state;
				qcom,mdss-dsi-lp11-init;
				qcom,mdss-dsi-mdp-trigger = "none";
				qcom,mdss-dsi-off-command = [05 01 00 00 14 00 02 28 00 05 01 00 00 78 00 02 10 00];
				qcom,mdss-dsi-off-command-state = "dsi_lp_mode";
				qcom,mdss-dsi-on-command = <0x29010000 0x6f0 0x55aa5208 0x290100 0x3 0xb1782123 0x1000000 0x2b60f 0x29010000 0x3bc 0x2901 0x0 0x6bd0267 0x20200029 0x1000000 0xbe7f2 0xe6d8ccbf 0xb2a59999 0x95290100 0xb 0xe8f2e6d8 0xccbfb2a5 0x99999529 0x1000000 0x6f055 0xaa520801 0x29010000 0x3bc 0xa0002901 0x0 0x3bda000 0x23010000 0x2ca 0x1230100 0x2 0xc00c2301 0x0 0x2be4e29 0x1000000 0x3b338 0x38290100 0x3 0xb4111129 0x1000000 0x3b605 0x5290100 0x3 0xb9454529 0x1000000 0x3ba25 0x25290100 0x3 0xc4111123 0x1000000 0x2c666 0x29010000 0x6f0 0x55aa5208 0x2230100 0x2 0xee002901 0x0 0x11b00037 0x480069 0x8a00ab 0xcb00eb 0x11c2901 0x0 0x11b10141 0x17c01aa 0x1f3022d 0x22e0263 0x29d2901 0x0 0x11b202c3 0x2f60319 0x3540385 0x3b203c1 0x3d12901 0x0 0x5b303e0 0x3e82901 0x0 0x11bc0037 0x480069 0x8a00ab 0xcb00eb 0x11c2901 0x0 0x11bd0141 0x17c01aa 0x1f3022d 0x22e0263 0x29d2901 0x0 0x11be02c3 0x2f60319 0x3540385 0x3b203c1 0x3d12901 0x0 0x5bf03e0 0x3e82901 0x0 0x11b400d1 0xd700e4 0xf100fe 0x1120126 0x1482901 0x0 0x11b50164 0x19501bd 0x2010236 0x238026c 0x2a72901 0x0 0x11b602ce 0x304032b 0x35b0389 0x3b203c1 0x3d12901 0x0 0x5b703e0 0x3e82901 0x0 0x11c000d1 0xd700e4 0xf100fe 0x1120126 0x1482901 0x0 0x11c10164 0x19501bd 0x2010236 0x238026c 0x2a72901 0x0 0x11c202ce 0x304032b 0x35b0389 0x3b203c1 0x3d12901 0x0 0x5c303e0 0x3e82901 0x0 0x11b80037 0x450061 0x7d009a 0xbb00dc 0x10b2901 0x0 0x11b90131 0x16e019e 0x1ea0224 0x2250258 0x2902901 0x0 0x11ba02b4 0x2e40304 0x344037f 0x3b203c1 0x3d12901 0x0 0x5bb03e0 0x3e82901 0x0 0x11c40037 0x450061 0x7d009a 0xbb00dc 0x10b2901 0x0 0x11c50131 0x16e019e 0x1ea0224 0x2250258 0x2902901 0x0 0x11c602b4 0x2e40304 0x344037f 0x3b203c1 0x3d12901 0x0 0x5c703e0 0x3e82901 0x0 0x6f055aa 0x52080629 0x1000000 0x3b029 0x2a290100 0x3 0xb1101229 0x1000000 0x3b214 0x16290100 0x3 0xb3181a29 0x1000000 0x3b402 0x4290100 0x3 0xb5343429 0x1000000 0x3b634 0x2e290100 0x3 0xb72e2e29 0x1000000 0x3b834 0x290100 0x3 0xb9343429 0x1000000 0x3ba34 0x34290100 0x3 0xbb013429 0x1000000 0x3bc2e 0x2e290100 0x3 0xbd2e3429 0x1000000 0x3be34 0x34290100 0x3 0xbf050329 0x1000000 0x3c01b 0x19290100 0x3 0xc1171529 0x1000000 0x3c213 0x11290100 0x3 0xc32a2929 0x1000000 0x3e52e 0x2e290100 0x3 0xc4292a29 0x1000000 0x3c51b 0x19290100 0x3 0xc6171529 0x1000000 0x3c713 0x11290100 0x3 0xc8010529 0x1000000 0x3c934 0x34290100 0x3 0xca342e29 0x1000000 0x3cb2e 0x2e290100 0x3 0xcc340329 0x1000000 0x3cd34 0x34290100 0x3 0xce343429 0x1000000 0x3cf02 0x34290100 0x3 0xd02e2e29 0x1000000 0x3d12e 0x34290100 0x3 0xd2343429 0x1000000 0x3d304 0x290100 0x3 0xd4101229 0x1000000 0x3d514 0x16290100 0x3 0xd6181a29 0x1000000 0x3d72a 0x29290100 0x3 0xe62e2e29 0x1000000 0x6d800 0x5400 0x29010000 0x6d9 0x150000 0x230100 0x2 0xe7002901 0x0 0x6f055aa 0x52080329 0x1000000 0x3b100 0x290100 0x3 0xb0000029 0x1000000 0x6b205 0x0 0x29010000 0x6b3 0x5000000 0x290100 0x6 0xb4050000 0x2901 0x0 0x6b50500 0x17000029 0x1000000 0x6b612 0x190000 0x29010000 0x6b7 0x12001900 0x290100 0x6 0xb8120019 0x2901 0x0 0x6b91200 0x19000029 0x1000000 0x6ba57 0x0 0x29010000 0x6bb 0x57000000 0x290100 0x6 0xbc75001a 0x2901 0x0 0x6bd5300 0x1a000029 0x1000000 0x5c000 0x34000029 0x1000000 0x5c100 0x34000029 0x1000000 0x5c200 0x34000029 0x1000000 0x5c300 0x34000023 0x1000000 0x2c420 0x23010000 0x2c5 0x230100 0x2 0xc6002301 0x0 0x2c70029 0x1000000 0x6f055 0xaa520805 0x23010000 0x2ed 0x30290100 0x3 0xb0170623 0x1000000 0x2b808 0x29010000 0x6bd 0x3070003 0x290100 0x3 0xb1170623 0x1000000 0x2b900 0x29010000 0x3b2 0x2301 0x0 0x2ba0029 0x1000000 0x3b317 0x6230100 0x2 0xbb0a2901 0x0 0x3b41706 0x29010000 0x3b5 0x17062901 0x0 0x3b61403 0x29010000 0x3b7 0x2301 0x0 0x2bc0223 0x1000000 0x2e506 0x23010000 0x2e6 0x6230100 0x2 0xe7002301 0x0 0x2e80623 0x1000000 0x2e906 0x23010000 0x2ea 0x6230100 0x2 0xeb002301 0x0 0x2ec0023 0x1000000 0x2c007 0x23010000 0x2c1 0x80230100 0x2 0xc2a42301 0x0 0x2c30523 0x1000000 0x2c400 0x23010000 0x2c5 0x2230100 0x2 0xc6222301 0x0 0x2c70329 0x1000000 0x3c805 0x30290100 0x3 0xc9013129 0x1000000 0x3ca03 0x21290100 0x3 0xcb012029 0x1000000 0x6d100 0x5090710 0x29010000 0x6d2 0x10050e03 0x10290100 0x6 0xd3200048 0x7102901 0x0 0x6d43000 0x43071023 0x1000000 0x2d000 0x29010000 0x4cc 0x3e29 0x1000000 0x4cd00 0x3e2901 0x0 0x4ce0000 0x2290100 0x4 0xcf000002 0x23010000 0x26f 0x11230100 0x2 0xf3011501 0x0 0x251ff15 0x1000000 0x2532c 0x15010000 0x255 0x3150100 0xc80002 0x35000501 0x7800 0x2110005 0x100000a 0x22900>;
				qcom,mdss-dsi-on-command-state = "dsi_lp_mode";
				qcom,mdss-dsi-panel-framerate = <0x3c>;
				qcom,mdss-dsi-panel-height = <0x500>;
				qcom,mdss-dsi-panel-name = "truly 720p cmd mode dsi panel";
				qcom,mdss-dsi-panel-timings = <0x872c1200 0x4044161e 0x17030400>;
				qcom,mdss-dsi-panel-type = "dsi_cmd_mode";
				qcom,mdss-dsi-panel-width = <0x2d0>;
				qcom,mdss-dsi-post-init-delay = <0x1>;
				qcom,mdss-dsi-reset-sequence = <0x1 0xa 0x0 0xa 0x1 0xa>;
				qcom,mdss-dsi-stream = <0x0>;
				qcom,mdss-dsi-t-clk-post = <0x4>;
				qcom,mdss-dsi-t-clk-pre = <0x1b>;
				qcom,mdss-dsi-te-check-enable;
				qcom,mdss-dsi-te-dcs-command = <0x1>;
				qcom,mdss-dsi-te-pin-select = <0x1>;
				qcom,mdss-dsi-te-using-te-pin;
				qcom,mdss-dsi-traffic-mode = "burst_mode";
				qcom,mdss-dsi-tx-eot-append;
				qcom,mdss-dsi-underflow-color = <0xff>;
				qcom,mdss-dsi-v-back-porch = <0x20>;
				qcom,mdss-dsi-v-bottom-border = <0x0>;
				qcom,mdss-dsi-v-front-porch = <0x20>;
				qcom,mdss-dsi-v-pulse-width = <0x2>;
				qcom,mdss-dsi-v-top-border = <0x0>;
				qcom,mdss-dsi-virtual-channel-id = <0x0>;
				qcom,mdss-dsi-wr-mem-continue = <0x3c>;
				qcom,mdss-dsi-wr-mem-start = <0x2c>;
			};
		};
	};

	fragment@16 {
		target = <0xffffffff>;

		__overlay__ {

			qcom,mdss_dsi_r69006_1080p_cmd {
				phandle = <0xe>;
				qcom,mdss-dsi-bl-max-level = <0xfff>;
				qcom,mdss-dsi-bl-min-level = <0x1>;
				qcom,mdss-dsi-bl-pmic-control-type = "bl_ctrl_wled";
				qcom,mdss-dsi-bllp-eof-power-mode;
				qcom,mdss-dsi-bllp-power-mode;
				qcom,mdss-dsi-border-color = <0x0>;
				qcom,mdss-dsi-bpp = <0x18>;
				qcom,mdss-dsi-dma-trigger = "trigger_sw";
				qcom,mdss-dsi-h-back-porch = <0x52>;
				qcom,mdss-dsi-h-front-porch = <0x64>;
				qcom,mdss-dsi-h-left-border = <0x0>;
				qcom,mdss-dsi-h-pulse-width = <0x14>;
				qcom,mdss-dsi-h-right-border = <0x0>;
				qcom,mdss-dsi-h-sync-skew = <0x0>;
				qcom,mdss-dsi-lane-0-state;
				qcom,mdss-dsi-lane-1-state;
				qcom,mdss-dsi-lane-2-state;
				qcom,mdss-dsi-lane-3-state;
				qcom,mdss-dsi-mdp-trigger = "none";
				qcom,mdss-dsi-off-command = [05 01 00 00 0a 00 02 28 00 29 01 00 00 00 00 1d d3 13 3b bb a5 a5 33 33 33 00 80 a4 a8 37 33 33 33 33 f7 f2 1f 7d 7c ff 0f 99 00 ff ff 05 01 00 00 5a 00 02 10 00];
				qcom,mdss-dsi-off-command-state = "dsi_hs_mode";
				qcom,mdss-dsi-on-command = [23 01 00 00 00 00 02 b0 00 29 01 00 00 00 00 06 b3 04 10 00 00 00 29 01 00 00 00 00 03 b4 0c 00 29 01 00 00 00 00 04 b6 3b d3 00 23 01 00 00 00 00 02 c0 00 15 01 00 00 00 00 02 36 98 23 01 00 00 00 00 02 cc 04 29 01 00 00 00 00 20 c1 84 00 10 ef 8b f1 ff ff df 9c c5 9a 73 8d ad 63 fe ff ff cb f8 01 00 aa 40 02 c2 01 08 00 01 29 01 00 00 00 00 0a cb 0d fe 1f 2c 00 00 00 00 00 29 01 00 00 00 00 0b c2 01 f7 80 04 63 00 60 00 01 30 29 01 00 00 00 00 07 c3 55 01 00 01 00 00 29 01 00 00 00 00 12 c4 70 00 00 00 00 00 00 00 00 02 01 00 05 01 00 00 00 29 01 00 00 00 00 0f c6 57 07 4a 07 4a 01 0e 01 02 01 02 09 15 07 29 01 00 00 00 00 1f c7 00 06 0c 16 27 35 3f 4d 33 3c 49 5b 64 66 67 00 06 0c 16 27 35 3f 4d 33 3c 49 5b 64 66 67 29 01 00 00 00 00 14 c8 00 00 fe 01 08 e7 00 00 fd 02 03 a8 00 00 fc e7 e9 c9 00 29 01 00 00 00 00 09 c9 1f 68 1f 68 4c 4c c4 11 29 01 00 00 00 00 11 d0 11 01 91 0b d9 19 19 00 00 00 19 99 00 00 00 00 29 01 00 00 00 00 1d d3 1b 3b bb ad a5 33 33 33 00 80 ad a8 37 33 33 33 33 f7 f2 1f 7d 7c ff 0f 99 00 ff ff 29 01 00 00 00 00 04 d4 57 33 03 29 01 00 00 00 00 0c d5 66 00 00 01 32 01 32 00 0b 00 0b 29 01 00 00 00 00 02 be 04 29 01 00 00 00 00 11 cf 40 10 00 00 00 00 32 00 00 00 00 00 00 00 00 00 29 01 00 00 00 00 06 de 00 00 3f ff 10 29 01 00 00 00 00 02 e9 00 29 01 00 00 00 00 02 f2 00 23 01 00 00 00 00 02 d6 01 39 01 00 00 00 00 02 35 00 39 01 00 00 00 00 02 51 ff 39 01 00 00 00 00 02 53 2c 39 01 00 00 00 00 02 55 00 05 01 00 00 78 00 02 11 00 05 01 00 00 14 00 02 29 00];
				qcom,mdss-dsi-on-command-state = "dsi_lp_mode";
				qcom,mdss-dsi-panel-framerate = <0x3c>;
				qcom,mdss-dsi-panel-height = <0x780>;
				qcom,mdss-dsi-panel-max-error-count = <0x3>;
				qcom,mdss-dsi-panel-name = "r69006 1080p cmd mode dsi panel";
				qcom,mdss-dsi-panel-status-check-mode = "reg_read";
				qcom,mdss-dsi-panel-status-command = <0x6010001 0x500010a>;
				qcom,mdss-dsi-panel-status-command-mode = "dsi_lp_mode";
				qcom,mdss-dsi-panel-status-read-length = <0x1>;
				qcom,mdss-dsi-panel-status-value = <0x1c>;
				qcom,mdss-dsi-panel-timings = <0x6e3f3600 0x5a4f3841 0x54030400>;
				qcom,mdss-dsi-panel-type = "dsi_cmd_mode";
				qcom,mdss-dsi-panel-width = <0x438>;
				qcom,mdss-dsi-reset-sequence = <0x1 0xa 0x0 0xa 0x1 0xa>;
				qcom,mdss-dsi-rx-eot-ignore;
				qcom,mdss-dsi-stream = <0x0>;
				qcom,mdss-dsi-t-clk-post = <0x1e>;
				qcom,mdss-dsi-t-clk-pre = <0x30>;
				qcom,mdss-dsi-te-check-enable;
				qcom,mdss-dsi-te-dcs-command = <0x1>;
				qcom,mdss-dsi-te-pin-select = <0x1>;
				qcom,mdss-dsi-te-using-te-pin;
				qcom,mdss-dsi-traffic-mode = "burst_mode";
				qcom,mdss-dsi-tx-eot-append;
				qcom,mdss-dsi-underflow-color = <0xff>;
				qcom,mdss-dsi-v-back-porch = <0x9>;
				qcom,mdss-dsi-v-bottom-border = <0x0>;
				qcom,mdss-dsi-v-front-porch = <0x3>;
				qcom,mdss-dsi-v-pulse-width = <0xf>;
				qcom,mdss-dsi-v-top-border = <0x0>;
				qcom,mdss-dsi-virtual-channel-id = <0x0>;
				qcom,mdss-dsi-wr-mem-continue = <0x3c>;
				qcom,mdss-dsi-wr-mem-start = <0x2c>;
			};
		};
	};

	fragment@17 {
		target = <0xffffffff>;

		__overlay__ {

			qcom,mdss_dsi_r69006_1080p_video {
				phandle = <0xf>;
				qcom,mdss-dsi-bl-max-level = <0xfff>;
				qcom,mdss-dsi-bl-min-level = <0x1>;
				qcom,mdss-dsi-bl-pmic-control-type = "bl_ctrl_wled";
				qcom,mdss-dsi-bllp-eof-power-mode;
				qcom,mdss-dsi-bllp-power-mode;
				qcom,mdss-dsi-border-color = <0x0>;
				qcom,mdss-dsi-bpp = <0x18>;
				qcom,mdss-dsi-dma-trigger = "trigger_sw";
				qcom,mdss-dsi-h-back-porch = <0x52>;
				qcom,mdss-dsi-h-front-porch = <0x64>;
				qcom,mdss-dsi-h-left-border = <0x0>;
				qcom,mdss-dsi-h-pulse-width = <0x14>;
				qcom,mdss-dsi-h-right-border = <0x0>;
				qcom,mdss-dsi-h-sync-pulse = <0x1>;
				qcom,mdss-dsi-h-sync-skew = <0x0>;
				qcom,mdss-dsi-lane-0-state;
				qcom,mdss-dsi-lane-1-state;
				qcom,mdss-dsi-lane-2-state;
				qcom,mdss-dsi-lane-3-state;
				qcom,mdss-dsi-mdp-trigger = "none";
				qcom,mdss-dsi-off-command = [05 01 00 00 78 00 02 28 00 05 01 00 00 96 00 02 10 00];
				qcom,mdss-dsi-off-command-state = "dsi_hs_mode";
				qcom,mdss-dsi-on-command = [23 01 00 00 00 00 02 b0 00 29 01 00 00 00 00 06 b3 05 10 00 00 00 29 01 00 00 00 00 03 b4 0c 00 29 01 00 00 00 00 04 b6 3b c3 00 23 01 00 00 00 00 02 c0 00 15 01 00 00 00 00 02 36 98 23 01 00 00 00 00 02 cc 04 29 01 00 00 00 00 20 c1 84 00 10 ef 8b f1 ff ff df 9c c5 9a 73 8d ad 63 fe ff ff cb f8 01 00 aa 40 00 c2 01 08 00 01 29 01 00 00 00 00 0a cb 0d fe 1f 2c 00 00 00 00 00 29 01 00 00 00 00 0b c2 01 f7 80 04 63 00 60 00 01 30 29 01 00 00 00 00 07 c3 55 01 00 01 00 00 29 01 00 00 00 00 12 c4 70 00 00 00 00 00 00 00 00 02 01 00 05 01 00 00 00 29 01 00 00 00 00 0f c6 59 07 4a 07 4a 01 0e 01 02 01 02 09 15 07 29 01 00 00 00 00 1f c7 00 30 32 34 42 4e 56 62 44 4a 54 62 6b 73 7f 08 30 32 34 42 4e 56 62 44 4a 54 62 6b 73 7f 29 01 00 00 00 00 14 c8 00 00 00 00 00 fc 00 00 00 00 00 fc 00 00 00 00 00 fc 00 29 01 00 00 00 00 09 c9 1f 68 1f 68 4c 4c c4 11 29 01 00 00 00 00 11 d0 33 01 91 0b d9 19 19 00 00 00 19 99 00 00 00 00 29 01 00 00 00 00 1d d3 1b 3b bb ad a5 33 33 33 00 80 ad a8 6f 6f 33 33 33 f7 f2 1f 7d 7c ff 0f 99 00 ff ff 29 01 00 00 00 00 04 d4 57 33 03 29 01 00 00 00 00 0c d5 66 00 00 01 27 01 27 00 6d 00 6d 23 01 00 00 00 00 02 d6 81 05 01 00 00 78 00 02 11 00 05 01 00 00 78 00 02 29 00];
				qcom,mdss-dsi-on-command-state = "dsi_lp_mode";
				qcom,mdss-dsi-panel-framerate = <0x3c>;
				qcom,mdss-dsi-panel-height = <0x780>;
				qcom,mdss-dsi-panel-max-error-count = <0x3>;
				qcom,mdss-dsi-panel-name = "r69006 1080p video mode dsi panel";
				qcom,mdss-dsi-panel-status-check-mode = "reg_read";
				qcom,mdss-dsi-panel-status-command = <0x6010001 0x500010a>;
				qcom,mdss-dsi-panel-status-command-mode = "dsi_lp_mode";
				qcom,mdss-dsi-panel-status-read-length = <0x1>;
				qcom,mdss-dsi-panel-status-value = <0x1c>;
				qcom,mdss-dsi-panel-timings = <0x7d251d00 0x37332227 0x1e030400>;
				qcom,mdss-dsi-panel-type = "dsi_video_mode";
				qcom,mdss-dsi-panel-width = <0x438>;
				qcom,mdss-dsi-reset-sequence = <0x1 0x14 0x0 0x2 0x1 0x14>;
				qcom,mdss-dsi-stream = <0x0>;
				qcom,mdss-dsi-t-clk-post = <0x20>;
				qcom,mdss-dsi-t-clk-pre = <0x2c>;
				qcom,mdss-dsi-traffic-mode = "burst_mode";
				qcom,mdss-dsi-underflow-color = <0xff>;
				qcom,mdss-dsi-v-back-porch = <0x9>;
				qcom,mdss-dsi-v-bottom-border = <0x0>;
				qcom,mdss-dsi-v-front-porch = <0x3>;
				qcom,mdss-dsi-v-pulse-width = <0xf>;
				qcom,mdss-dsi-v-top-border = <0x0>;
				qcom,mdss-dsi-virtual-channel-id = <0x0>;
			};
		};
	};

	fragment@18 {
		target = <0xffffffff>;

		__overlay__ {

			qcom,mdss_dsi_hx8394f_720p_video {
				phandle = <0x10>;
				qcom,mdss-dsi-bl-max-level = <0xfff>;
				qcom,mdss-dsi-bl-min-level = <0x1>;
				qcom,mdss-dsi-bl-pmic-control-type = "bl_ctrl_wled";
				qcom,mdss-dsi-bllp-eof-power-mode;
				qcom,mdss-dsi-bllp-power-mode;
				qcom,mdss-dsi-border-color = <0x0>;
				qcom,mdss-dsi-bpp = <0x18>;
				qcom,mdss-dsi-dma-trigger = "trigger_sw";
				qcom,mdss-dsi-h-back-porch = <0x10>;
				qcom,mdss-dsi-h-front-porch = <0x10>;
				qcom,mdss-dsi-h-left-border = <0x0>;
				qcom,mdss-dsi-h-pulse-width = <0xa>;
				qcom,mdss-dsi-h-right-border = <0x0>;
				qcom,mdss-dsi-h-sync-pulse = <0x1>;
				qcom,mdss-dsi-h-sync-skew = <0x0>;
				qcom,mdss-dsi-lane-0-state;
				qcom,mdss-dsi-lane-1-state;
				qcom,mdss-dsi-lane-2-state;
				qcom,mdss-dsi-lane-3-state;
				qcom,mdss-dsi-lane-map = "lane_map_0123";
				qcom,mdss-dsi-mdp-trigger = "none";
				qcom,mdss-dsi-off-command = [05 01 00 00 78 00 02 28 00 05 01 00 00 96 00 02 10 00];
				qcom,mdss-dsi-off-command-state = "dsi_hs_mode";
				qcom,mdss-dsi-on-command = [39 01 00 00 00 00 04 b9 ff 83 94 39 01 00 00 00 00 07 ba 63 03 68 6b b2 c0 39 01 00 00 00 00 0b b1 50 12 72 09 33 54 b1 31 6b 2f 39 01 00 00 00 00 07 b2 00 80 64 0e 0d 2f 39 01 00 00 00 00 16 b4 73 74 73 74 73 74 01 0c 86 75 00 3f 73 74 73 74 73 74 01 0c 86 39 01 00 00 00 00 22 d3 00 00 07 07 40 07 10 00 08 10 08 00 08 54 15 0e 05 0e 02 15 06 05 06 47 44 0a 0a 4b 10 07 07 0e 40 39 01 00 00 00 00 2d d5 1a 1a 1b 1b 00 01 02 03 04 05 06 07 08 09 0a 0b 24 25 18 18 26 27 18 18 18 18 18 18 18 18 18 18 18 18 18 18 18 18 20 21 18 18 18 18 39 01 00 00 00 00 2d d6 1a 1a 1b 1b 0b 0a 09 08 07 06 05 04 03 02 01 00 21 20 18 18 27 26 18 18 18 18 18 18 18 18 18 18 18 18 18 18 18 18 25 24 18 18 18 18 39 01 00 00 00 00 3b e0 00 0c 19 20 23 26 29 28 51 61 70 6f 76 86 89 8d 99 9a 95 a1 b0 57 55 58 5c 5e 64 6b 7f 00 0c 19 20 23 26 29 28 51 61 70 6f 76 86 89 8d 99 9a 95 a1 b0 57 55 58 5c 5e 64 6b 7f 39 01 00 00 00 00 03 c0 1f 31 15 01 00 00 00 00 02 cc 0b 15 01 00 00 00 00 02 d4 02 15 01 00 00 00 00 02 bd 02 39 01 00 00 00 00 0d d8 ff ff ff ff ff ff ff ff ff ff ff ff 15 01 00 00 00 00 02 bd 00 15 01 00 00 00 00 02 bd 01 15 01 00 00 00 00 02 b1 00 15 01 00 00 00 00 02 bd 00 39 01 00 00 00 00 08 bf 40 81 50 00 1a fc 01 39 01 00 00 00 00 03 b6 7d 7d 05 01 00 00 78 00 02 11 00 39 01 00 00 00 00 0d b2 00 80 64 0e 0d 2f 00 00 00 00 c0 18 05 01 00 00 14 00 02 29 00];
				qcom,mdss-dsi-on-command-state = "dsi_lp_mode";
				qcom,mdss-dsi-panel-controller = <0xffffffff>;
				qcom,mdss-dsi-panel-destination = "display_1";
				qcom,mdss-dsi-panel-framerate = <0x3c>;
				qcom,mdss-dsi-panel-height = <0x500>;
				qcom,mdss-dsi-panel-max-error-count = <0x3>;
				qcom,mdss-dsi-panel-name = "hx8394f 720p video mode dsi panel";
				qcom,mdss-dsi-panel-status-check-mode = "reg_read";
				qcom,mdss-dsi-panel-status-command = <0x6010001 0x50001d9 0x6010001 0x5000109 0x6010001 0x5000145>;
				qcom,mdss-dsi-panel-status-command-state = "dsi_lp_mode";
				qcom,mdss-dsi-panel-status-read-length = <0x4 0x4 0x3>;
				qcom,mdss-dsi-panel-status-valid-params = <0x1 0x3 0x2>;
				qcom,mdss-dsi-panel-status-value = <0x80 0x80 0x73 0x4 0x5 0xf 0x80 0x80 0x73 0x4 0x5 0x1e>;
				qcom,mdss-dsi-panel-timings = <0x72160e00 0x383c121a 0x10030400>;
				qcom,mdss-dsi-panel-type = "dsi_video_mode";
				qcom,mdss-dsi-panel-width = <0x2d0>;
				qcom,mdss-dsi-reset-sequence = <0x1 0x14 0x0 0x2 0x1 0x14>;
				qcom,mdss-dsi-stream = <0x0>;
				qcom,mdss-dsi-t-clk-post = <0x4>;
				qcom,mdss-dsi-t-clk-pre = <0x18>;
				qcom,mdss-dsi-traffic-mode = "burst_mode";
				qcom,mdss-dsi-underflow-color = <0xff>;
				qcom,mdss-dsi-v-back-porch = <0xc>;
				qcom,mdss-dsi-v-bottom-border = <0x0>;
				qcom,mdss-dsi-v-front-porch = <0xf>;
				qcom,mdss-dsi-v-pulse-width = <0x4>;
				qcom,mdss-dsi-v-top-border = <0x0>;
				qcom,mdss-dsi-virtual-channel-id = <0x0>;
			};
		};
	};

	fragment@19 {
		target = <0xffffffff>;

		__overlay__ {

			qcom,mdss_dsi_adv7533_1080p {
				label = "adv7533 1080p video mode dsi panel";
				phandle = <0x11>;
				qcom,bridge-name = "adv7533";
				qcom,dba-panel;
				qcom,mdss-dsi-always-on;
				qcom,mdss-dsi-bl-max-level = <0xfff>;
				qcom,mdss-dsi-bl-min-level = <0x1>;
				qcom,mdss-dsi-bllp-eof-power-mode;
				qcom,mdss-dsi-bllp-power-mode;
				qcom,mdss-dsi-border-color = <0x0>;
				qcom,mdss-dsi-bpp = <0x18>;
				qcom,mdss-dsi-dma-trigger = "trigger_sw";
				qcom,mdss-dsi-force-clock-lane-hs;
				qcom,mdss-dsi-h-back-porch = <0x94>;
				qcom,mdss-dsi-h-front-porch = <0x58>;
				qcom,mdss-dsi-h-left-border = <0x0>;
				qcom,mdss-dsi-h-pulse-width = <0x2c>;
				qcom,mdss-dsi-h-right-border = <0x0>;
				qcom,mdss-dsi-h-sync-pulse = <0x1>;
				qcom,mdss-dsi-h-sync-skew = <0x0>;
				qcom,mdss-dsi-lane-0-state;
				qcom,mdss-dsi-lane-1-state;
				qcom,mdss-dsi-lane-2-state;
				qcom,mdss-dsi-lane-3-state;
				qcom,mdss-dsi-mdp-trigger = "none";
				qcom,mdss-dsi-off-command = [05 01 00 00 00 00 02 28 00 05 01 00 00 00 00 02 10 00];
				qcom,mdss-dsi-off-command-state = "dsi_hs_mode";
				qcom,mdss-dsi-on-command = [05 01 00 00 c8 00 02 11 00 05 01 00 00 0a 00 02 29 00];
				qcom,mdss-dsi-on-command-state = "dsi_lp_mode";
				qcom,mdss-dsi-panel-controller = <0xffffffff>;
				qcom,mdss-dsi-panel-destination = "display_1";
				qcom,mdss-dsi-panel-framerate = <0x3c>;
				qcom,mdss-dsi-panel-height = <0x438>;
				qcom,mdss-dsi-panel-name = "dsi_adv7533_1080p";
				qcom,mdss-dsi-panel-timings = <0xe6382600 0x686c2a3a 0x2c030400>;
				qcom,mdss-dsi-panel-timings-phy-v2 = <0x1d1a0305 0x10304a0 0x1d1a0305 0x10304a0 0x1d1a0305 0x10304a0 0x1d1a0305 0x10304a0 0x1d1a0305 0x10304a0>;
				qcom,mdss-dsi-panel-type = "dsi_video_mode";
				qcom,mdss-dsi-panel-width = <0x780>;
				qcom,mdss-dsi-reset-sequence = <0x1 0x14 0x0 0x1 0x1 0x14>;
				qcom,mdss-dsi-stream = <0x0>;
				qcom,mdss-dsi-t-clk-post = <0x2>;
				qcom,mdss-dsi-t-clk-pre = <0x2b>;
				qcom,mdss-dsi-traffic-mode = "non_burst_sync_pulse";
				qcom,mdss-dsi-underflow-color = <0xff>;
				qcom,mdss-dsi-v-back-porch = <0x24>;
				qcom,mdss-dsi-v-bottom-border = <0x0>;
				qcom,mdss-dsi-v-front-porch = <0x4>;
				qcom,mdss-dsi-v-pulse-width = <0x5>;
				qcom,mdss-dsi-v-top-border = <0x0>;
				qcom,mdss-dsi-virtual-channel-id = <0x0>;
				qcom,mdss-pan-physical-height-dimension = <0x5a>;
				qcom,mdss-pan-physical-width-dimension = <0xa0>;
			};
		};
	};

	fragment@2 {
		target = <0xffffffff>;

		__overlay__ {
			qcom,batt-hot-percentage = <0x23>;
			qcom,chgr-led-support;
			qcom,vddmax-mv = <0x1130>;
			qcom,vddsafe-mv = <0x1130>;
			status = "ok";
		};
	};

	fragment@20 {
		target = <0xffffffff>;

		__overlay__ {

			qcom,mdss_dsi_adv7533_720p {
				label = "adv7533 720p video mode dsi panel";
				phandle = <0x12>;
				qcom,bridge-name = "adv7533";
				qcom,dba-panel;
				qcom,mdss-dsi-always-on;
				qcom,mdss-dsi-bl-max-level = <0xfff>;
				qcom,mdss-dsi-bl-min-level = <0x1>;
				qcom,mdss-dsi-bllp-eof-power-mode;
				qcom,mdss-dsi-bllp-power-mode;
				qcom,mdss-dsi-border-color = <0x0>;
				qcom,mdss-dsi-bpp = <0x18>;
				qcom,mdss-dsi-dma-trigger = "trigger_sw";
				qcom,mdss-dsi-force-clock-lane-hs;
				qcom,mdss-dsi-h-back-porch = <0xdc>;
				qcom,mdss-dsi-h-front-porch = <0x6e>;
				qcom,mdss-dsi-h-left-border = <0x0>;
				qcom,mdss-dsi-h-pulse-width = <0x28>;
				qcom,mdss-dsi-h-right-border = <0x0>;
				qcom,mdss-dsi-h-sync-pulse = <0x1>;
				qcom,mdss-dsi-h-sync-skew = <0x0>;
				qcom,mdss-dsi-lane-0-state;
				qcom,mdss-dsi-lane-1-state;
				qcom,mdss-dsi-lane-2-state;
				qcom,mdss-dsi-mdp-trigger = "none";
				qcom,mdss-dsi-off-command = [05 01 00 00 00 00 02 28 00 05 01 00 00 00 00 02 10 00];
				qcom,mdss-dsi-off-command-state = "dsi_hs_mode";
				qcom,mdss-dsi-on-command = [05 01 00 00 c8 00 02 11 00 05 01 00 00 0a 00 02 29 00];
				qcom,mdss-dsi-on-command-state = "dsi_lp_mode";
				qcom,mdss-dsi-panel-controller = <0xffffffff>;
				qcom,mdss-dsi-panel-destination = "display_1";
				qcom,mdss-dsi-panel-framerate = <0x3c>;
				qcom,mdss-dsi-panel-height = <0x2d0>;
				qcom,mdss-dsi-panel-name = "dsi_adv7533_720p";
				qcom,mdss-dsi-panel-timings = <0xa4241800 0x4e521c28 0x1c030400>;
				qcom,mdss-dsi-panel-timings-phy-v2 = <0x1c190203 0x10304a0 0x1c190203 0x10304a0 0x1c190203 0x10304a0 0x1c190203 0x10304a0 0x1c080203 0x10304a0>;
				qcom,mdss-dsi-panel-type = "dsi_video_mode";
				qcom,mdss-dsi-panel-width = <0x500>;
				qcom,mdss-dsi-reset-sequence = <0x1 0x14 0x0 0x1 0x1 0x14>;
				qcom,mdss-dsi-stream = <0x0>;
				qcom,mdss-dsi-t-clk-post = <0x3>;
				qcom,mdss-dsi-t-clk-pre = <0x20>;
				qcom,mdss-dsi-traffic-mode = "non_burst_sync_pulse";
				qcom,mdss-dsi-underflow-color = <0xff>;
				qcom,mdss-dsi-v-back-porch = <0x14>;
				qcom,mdss-dsi-v-bottom-border = <0x0>;
				qcom,mdss-dsi-v-front-porch = <0x5>;
				qcom,mdss-dsi-v-pulse-width = <0x5>;
				qcom,mdss-dsi-v-top-border = <0x0>;
				qcom,mdss-dsi-virtual-channel-id = <0x0>;
				qcom,mdss-pan-physical-height-dimension = <0x5a>;
				qcom,mdss-pan-physical-width-dimension = <0xa0>;
			};
		};
	};

	fragment@21 {
		target = <0xffffffff>;

		__overlay__ {

			qcom,mdss_dsi_hx8399c_truly_video {
				phandle = <0x13>;
				qcom,mdss-dsi-bllp-eof-power-mode;
				qcom,mdss-dsi-bllp-power-mode;
				qcom,mdss-dsi-border-color = <0x0>;
				qcom,mdss-dsi-bpp = <0x18>;
				qcom,mdss-dsi-color-order = "rgb_swap_rgb";
				qcom,mdss-dsi-dma-trigger = "trigger_sw";
				qcom,mdss-dsi-h-back-porch = <0x2a>;
				qcom,mdss-dsi-h-front-porch = <0x2a>;
				qcom,mdss-dsi-h-left-border = <0x0>;
				qcom,mdss-dsi-h-pulse-width = <0xa>;
				qcom,mdss-dsi-h-right-border = <0x0>;
				qcom,mdss-dsi-h-sync-pulse = <0x0>;
				qcom,mdss-dsi-h-sync-skew = <0x0>;
				qcom,mdss-dsi-lane-0-state;
				qcom,mdss-dsi-lane-1-state;
				qcom,mdss-dsi-lane-2-state;
				qcom,mdss-dsi-lane-3-state;
				qcom,mdss-dsi-lane-map = "lane_map_0123";
				qcom,mdss-dsi-lp11-init;
				qcom,mdss-dsi-mdp-trigger = "none";
				qcom,mdss-dsi-off-command = [05 01 00 00 32 00 02 28 00 05 01 00 00 96 00 02 10 00];
				qcom,mdss-dsi-off-command-state = "dsi_hs_mode";
				qcom,mdss-dsi-on-command = [39 01 00 00 00 00 04 b9 ff 83 99 39 01 00 00 00 00 02 d2 88 39 01 00 00 00 00 0c b1 02 04 72 92 01 32 aa 11 11 52 57 39 01 00 00 00 00 10 b2 00 80 80 cc 05 07 5a 11 10 10 00 1e 70 03 d4 39 01 00 00 00 00 2d b4 00 ff 59 59 01 ab 00 00 09 00 03 05 00 28 03 0b 0d 21 03 02 00 0c a3 80 59 59 02 ab 00 00 09 00 03 05 00 28 03 0b 0d 02 00 0c a3 01 39 01 00 00 05 00 22 d3 00 0c 03 03 00 00 10 10 00 00 03 00 03 00 08 78 08 78 00 00 00 00 00 24 02 05 05 03 00 00 00 05 40 39 01 00 00 05 00 21 d5 20 20 19 19 18 18 02 03 00 01 24 24 18 18 18 18 24 24 00 00 00 00 00 00 00 00 2f 2f 30 30 31 31 39 01 00 00 05 00 21 d6 24 24 18 18 19 19 01 00 03 02 24 24 18 18 18 18 20 20 40 40 40 40 40 40 40 40 2f 2f 30 30 31 31 39 01 00 00 00 00 02 bd 00 39 01 00 00 00 00 11 d8 aa aa aa aa aa aa aa aa aa ba aa aa aa ba aa aa 39 01 00 00 00 00 02 bd 01 39 01 00 00 00 00 11 d8 00 00 00 00 00 00 00 00 82 ea aa aa 82 ea aa aa 39 01 00 00 00 00 02 bd 02 39 01 00 00 00 00 09 d8 ff ff c0 3f ff ff c0 3f 39 01 00 00 00 00 02 bd 00 39 01 00 00 05 00 37 e0 01 21 31 2d 66 6f 7b 75 7a 81 86 89 8c 90 95 97 9a a1 a2 aa 9e ad b0 5b 57 63 7a 01 21 31 2d 66 6f 7b 75 7a 81 86 89 8c 90 95 97 9a a1 a2 aa 9e ad b0 5b 57 63 7a 39 01 00 00 00 00 03 b6 7e 7e 39 01 00 00 00 00 02 cc 08 05 01 00 00 96 00 02 11 00 05 01 00 00 32 00 02 29 00];
				qcom,mdss-dsi-on-command-state = "dsi_lp_mode";
				qcom,mdss-dsi-panel-framerate = <0x3c>;
				qcom,mdss-dsi-panel-height = <0x870>;
				qcom,mdss-dsi-panel-name = "hx8399c video mode dsi truly panel";
				qcom,mdss-dsi-panel-type = "dsi_video_mode";
				qcom,mdss-dsi-panel-width = <0x438>;
				qcom,mdss-dsi-reset-sequence = <0x1 0xa 0x0 0xa 0x1 0xa>;
				qcom,mdss-dsi-stream = <0x0>;
				qcom,mdss-dsi-t-clk-post = <0xe>;
				qcom,mdss-dsi-t-clk-pre = <0x31>;
				qcom,mdss-dsi-traffic-mode = "non_burst_sync_event";
				qcom,mdss-dsi-tx-eot-append;
				qcom,mdss-dsi-underflow-color = <0xff>;
				qcom,mdss-dsi-v-back-porch = <0xf>;
				qcom,mdss-dsi-v-bottom-border = <0x0>;
				qcom,mdss-dsi-v-front-porch = <0xa>;
				qcom,mdss-dsi-v-pulse-width = <0x3>;
				qcom,mdss-dsi-v-top-border = <0x0>;
				qcom,mdss-dsi-virtual-channel-id = <0x0>;
				qcom,mdss-pan-physical-height-dimension = <0x81>;
				qcom,mdss-pan-physical-width-dimension = <0x41>;
			};
		};
	};

	fragment@22 {
		target = <0xffffffff>;

		__overlay__ {

			qcom,mdss_dsi_hx8399c_hd_video {
				phandle = <0x7>;
				qcom,esd-check-enabled;
				qcom,mdss-dsi-bl-pmic-bank-select = <0x0>;
				qcom,mdss-dsi-bl-pmic-control-type = "bl_ctrl_pwm";
				qcom,mdss-dsi-bl-pmic-pwm-frequency = <0x64>;
				qcom,mdss-dsi-bllp-eof-power-mode;
				qcom,mdss-dsi-bllp-power-mode;
				qcom,mdss-dsi-border-color = <0x0>;
				qcom,mdss-dsi-bpp = <0x18>;
				qcom,mdss-dsi-color-order = "rgb_swap_rgb";
				qcom,mdss-dsi-dma-trigger = "trigger_sw";
				qcom,mdss-dsi-h-back-porch = <0x30>;
				qcom,mdss-dsi-h-front-porch = <0x30>;
				qcom,mdss-dsi-h-left-border = <0x0>;
				qcom,mdss-dsi-h-pulse-width = <0x10>;
				qcom,mdss-dsi-h-right-border = <0x0>;
				qcom,mdss-dsi-h-sync-pulse = <0x0>;
				qcom,mdss-dsi-h-sync-skew = <0x0>;
				qcom,mdss-dsi-lane-0-state;
				qcom,mdss-dsi-lane-1-state;
				qcom,mdss-dsi-lane-2-state;
				qcom,mdss-dsi-lane-3-state;
				qcom,mdss-dsi-lane-map = "lane_map_0123";
				qcom,mdss-dsi-lp11-init;
				qcom,mdss-dsi-max-refresh-rate = <0x3c>;
				qcom,mdss-dsi-mdp-trigger = "none";
				qcom,mdss-dsi-min-refresh-rate = <0x30>;
				qcom,mdss-dsi-off-command = [05 01 00 00 14 00 02 28 00 05 01 00 00 78 00 02 10 00];
				qcom,mdss-dsi-off-command-state = "dsi_hs_mode";
				qcom,mdss-dsi-on-command = <0x39010000 0x4b9 0xff839939 0x1000000 0x2d288 0x39010000 0xcb1 0x2047292 0x132aa11 0x11525739 0x1000000 0x10b200 0x8080cc05 0x75a1110 0x10001e70 0x3d43901 0x0 0x2db400ff 0x595901ab 0x900 0x3050028 0x30b0d21 0x302000c 0xa3805959 0x2ab0000 0x9000305 0x28030b 0xd02000c 0xa3013901 0x500 0x22d3000c 0x3030000 0x10100000 0x3000300 0x8780878 0x0 0x240205 0x5030000 0x54039 0x1000005 0x21d520 0x20191918 0x18020300 0x1242418 0x18181824 0x24000000 0x0 0x2f2f30 0x30313139 0x1000005 0x21d624 0x24181819 0x19010003 0x2242418 0x18181820 0x20404040 0x40404040 0x402f2f30 0x30313139 0x1000000 0x2bd00 0x39010000 0x11d8 0xaaaaaaaa 0xaaaaaaaa 0xaabaaaaa 0xaabaaaaa 0x39010000 0x2bd 0x1390100 0x11 0xd8000000 0x0 0x82eaaa 0xaa82eaaa 0xaa390100 0x2 0xbd023901 0x0 0x9d8ffff 0xc03fffff 0xc03f3901 0x0 0x2bd0039 0x1000005 0x37e001 0x21312d66 0x6f7b757a 0x8186898c 0x9095979a 0xa1a2aa9e 0xadb05b57 0x637a0121 0x312d666f 0x7b757a81 0x86898c90 0x95979aa1 0xa2aa9ead 0xb05b5763 0x7a390100 0x3 0xb67e7e39 0x1000000 0x2cc08 0x39010000 0x235 0x390100 0x2 0xdd030501 0x9600 0x2110005 0x1000014 0x22900>;
				qcom,mdss-dsi-on-command-state = "dsi_lp_mode";
				qcom,mdss-dsi-pan-enable-dynamic-fps;
				qcom,mdss-dsi-pan-fps-update = "dfps_immediate_porch_mode_vfp";
				qcom,mdss-dsi-panel-framerate = <0x3c>;
				qcom,mdss-dsi-panel-height = <0x5a0>;
				qcom,mdss-dsi-panel-max-error-count = <0x3>;
				qcom,mdss-dsi-panel-name = "hx8399c video mode dsi hd panel";
				qcom,mdss-dsi-panel-on-check-value = <0x9d 0x9d 0x9d 0x9d>;
				qcom,mdss-dsi-panel-status-check-mode = "reg_read";
				qcom,mdss-dsi-panel-status-command = <0x6010001 0x10a>;
				qcom,mdss-dsi-panel-status-command-state = "dsi_lp_mode";
				qcom,mdss-dsi-panel-status-read-length = <0x4>;
				qcom,mdss-dsi-panel-status-value = <0x9d 0x9d 0x9d 0x9d>;
				qcom,mdss-dsi-panel-timings = <0xe71c1200 0x42421820 0x17030400>;
				qcom,mdss-dsi-panel-type = "dsi_video_mode";
				qcom,mdss-dsi-panel-width = <0x2d0>;
				qcom,mdss-dsi-pwm-gpio = <0xffffffff 0x4 0x0>;
				qcom,mdss-dsi-reset-sequence = <0x1 0xa 0x0 0xa 0x1 0xa>;
				qcom,mdss-dsi-stream = <0x0>;
				qcom,mdss-dsi-t-clk-post = <0xa>;
				qcom,mdss-dsi-t-clk-pre = <0x1d>;
				qcom,mdss-dsi-traffic-mode = "non_burst_sync_event";
				qcom,mdss-dsi-tx-eot-append;
				qcom,mdss-dsi-underflow-color = <0xff>;
				qcom,mdss-dsi-v-back-porch = <0x28>;
				qcom,mdss-dsi-v-bottom-border = <0x0>;
				qcom,mdss-dsi-v-front-porch = <0x24>;
				qcom,mdss-dsi-v-pulse-width = <0x4>;
				qcom,mdss-dsi-v-top-border = <0x0>;
				qcom,mdss-dsi-virtual-channel-id = <0x0>;
				qcom,panel-supply-entries = <0x5>;
			};
		};
	};

	fragment@23 {
		target = <0xffffffff>;

		__overlay__ {

			qcom,mdss_dsi_nt35695b_truly_fhd_video {
				phandle = <0x14>;
				qcom,mdss-dsi-bl-max-level = <0xfff>;
				qcom,mdss-dsi-bl-min-level = <0x1>;
				qcom,mdss-dsi-bl-pmic-control-type = "bl_ctrl_wled";
				qcom,mdss-dsi-bllp-eof-power-mode;
				qcom,mdss-dsi-bllp-power-mode;
				qcom,mdss-dsi-border-color = <0x0>;
				qcom,mdss-dsi-bpp = <0x18>;
				qcom,mdss-dsi-dma-trigger = "trigger_sw";
				qcom,mdss-dsi-lane-0-state;
				qcom,mdss-dsi-lane-1-state;
				qcom,mdss-dsi-lane-2-state;
				qcom,mdss-dsi-lane-3-state;
				qcom,mdss-dsi-mdp-trigger = "none";
				qcom,mdss-dsi-panel-name = "nt35695b truly fhd video mode dsi panel";
				qcom,mdss-dsi-panel-type = "dsi_video_mode";
				qcom,mdss-dsi-post-init-delay = <0x1>;
				qcom,mdss-dsi-reset-sequence = <0x1 0xa 0x0 0xa 0x1 0xa>;
				qcom,mdss-dsi-stream = <0x0>;
				qcom,mdss-dsi-t-clk-post = <0xd>;
				qcom,mdss-dsi-t-clk-pre = <0x2f>;
				qcom,mdss-dsi-traffic-mode = "burst_mode";
				qcom,mdss-dsi-tx-eot-append;
				qcom,mdss-dsi-underflow-color = <0xff>;
				qcom,mdss-dsi-virtual-channel-id = <0x0>;

				qcom,mdss-dsi-display-timings {

					timing@0 {
						qcom,mdss-dsi-h-back-porch = <0x3c>;
						qcom,mdss-dsi-h-front-porch = <0x78>;
						qcom,mdss-dsi-h-left-border = <0x0>;
						qcom,mdss-dsi-h-pulse-width = <0xc>;
						qcom,mdss-dsi-h-right-border = <0x0>;
						qcom,mdss-dsi-h-sync-pulse = <0x0>;
						qcom,mdss-dsi-h-sync-skew = <0x0>;
						qcom,mdss-dsi-off-command = [05 01 00 00 14 00 02 28 00 05 01 00 00 78 00 02 10 00];
						qcom,mdss-dsi-off-command-state = "dsi_lp_mode";
						qcom,mdss-dsi-on-command = [15 01 00 00 10 00 02 ff 20 15 01 00 00 00 00 02 fb 01 15 01 00 00 00 00 02 00 01 15 01 00 00 00 00 02 01 55 15 01 00 00 00 00 02 02 45 15 01 00 00 00 00 02 03 55 15 01 00 00 00 00 02 05 50 15 01 00 00 00 00 02 06 a8 15 01 00 00 00 00 02 07 ad 15 01 00 00 00 00 02 08 0c 15 01 00 00 00 00 02 0b aa 15 01 00 00 00 00 02 0c aa 15 01 00 00 00 00 02 0e b0 15 01 00 00 00 00 02 0f b3 15 01 00 00 00 00 02 11 28 15 01 00 00 00 00 02 12 10 15 01 00 00 00 00 02 13 01 15 01 00 00 00 00 02 14 4a 15 01 00 00 00 00 02 15 12 15 01 00 00 00 00 02 16 12 15 01 00 00 00 00 02 30 01 15 01 00 00 00 00 02 72 11 15 01 00 00 00 00 02 58 82 15 01 00 00 00 00 02 59 00 15 01 00 00 00 00 02 5a 02 15 01 00 00 00 00 02 5b 00 15 01 00 00 00 00 02 5c 82 15 01 00 00 00 00 02 5d 80 15 01 00 00 00 00 02 5e 02 15 01 00 00 00 00 02 5f 00 15 01 00 00 00 00 02 ff 24 15 01 00 00 00 00 02 fb 01 15 01 00 00 00 00 02 00 01 15 01 00 00 00 00 02 01 0b 15 01 00 00 00 00 02 02 0c 15 01 00 00 00 00 02 03 89 15 01 00 00 00 00 02 04 8a 15 01 00 00 00 00 02 05 0f 15 01 00 00 00 00 02 06 10 15 01 00 00 00 00 02 07 10 15 01 00 00 00 00 02 08 1c 15 01 00 00 00 00 02 09 00 15 01 00 00 00 00 02 0a 00 15 01 00 00 00 00 02 0b 00 15 01 00 00 00 00 02 0c 00 15 01 00 00 00 00 02 0d 13 15 01 00 00 00 00 02 0e 15 15 01 00 00 00 00 02 0f 17 15 01 00 00 00 00 02 10 01 15 01 00 00 00 00 02 11 0b 15 01 00 00 00 00 02 12 0c 15 01 00 00 00 00 02 13 89 15 01 00 00 00 00 02 14 8a 15 01 00 00 00 00 02 15 0f 15 01 00 00 00 00 02 16 10 15 01 00 00 00 00 02 17 10 15 01 00 00 00 00 02 18 1c 15 01 00 00 00 00 02 19 00 15 01 00 00 00 00 02 1a 00 15 01 00 00 00 00 02 1b 00 15 01 00 00 00 00 02 1c 00 15 01 00 00 00 00 02 1d 13 15 01 00 00 00 00 02 1e 15 15 01 00 00 00 00 02 1f 17 15 01 00 00 00 00 02 20 00 15 01 00 00 00 00 02 21 01 15 01 00 00 00 00 02 22 00 15 01 00 00 00 00 02 23 40 15 01 00 00 00 00 02 24 40 15 01 00 00 00 00 02 25 6d 15 01 00 00 00 00 02 26 40 15 01 00 00 00 00 02 27 40 15 01 00 00 00 00 02 29 d8 15 01 00 00 00 00 02 2a 2a 15 01 00 00 00 00 02 4b 03 15 01 00 00 00 00 02 4c 11 15 01 00 00 00 00 02 4d 10 15 01 00 00 00 00 02 4e 01 15 01 00 00 00 00 02 4f 01 15 01 00 00 00 00 02 50 10 15 01 00 00 00 00 02 51 00 15 01 00 00 00 00 02 52 80 15 01 00 00 00 00 02 53 00 15 01 00 00 00 00 02 54 07 15 01 00 00 00 00 02 55 25 15 01 00 00 00 00 02 56 00 15 01 00 00 00 00 02 58 07 15 01 00 00 00 00 02 5b 43 15 01 00 00 00 00 02 5c 00 15 01 00 00 00 00 02 5f 73 15 01 00 00 00 00 02 60 73 15 01 00 00 00 00 02 63 22 15 01 00 00 00 00 02 64 00 15 01 00 00 00 00 02 67 08 15 01 00 00 00 00 02 68 04 15 01 00 00 00 00 02 7a 80 15 01 00 00 00 00 02 7b 91 15 01 00 00 00 00 02 7c d8 15 01 00 00 00 00 02 7d 60 15 01 00 00 00 00 02 93 06 15 01 00 00 00 00 02 94 06 15 01 00 00 00 00 02 8a 00 15 01 00 00 00 00 02 9b 0f 15 01 00 00 00 00 02 b3 c0 15 01 00 00 00 00 02 b4 00 15 01 00 00 00 00 02 b5 00 15 01 00 00 00 00 02 b6 21 15 01 00 00 00 00 02 b7 22 15 01 00 00 00 00 02 b8 07 15 01 00 00 00 00 02 b9 07 15 01 00 00 00 00 02 ba 22 15 01 00 00 00 00 02 bd 20 15 01 00 00 00 00 02 be 07 15 01 00 00 00 00 02 bf 07 15 01 00 00 00 00 02 c1 6d 15 01 00 00 00 00 02 c4 24 15 01 00 00 00 00 02 e3 00 15 01 00 00 00 00 02 ec 00 15 01 00 00 00 00 02 ff 10 15 01 00 00 00 00 02 bb 03 05 01 00 00 78 00 02 11 00 05 01 00 00 78 00 02 29 00];
						qcom,mdss-dsi-on-command-state = "dsi_lp_mode";
						qcom,mdss-dsi-panel-framerate = <0x3c>;
						qcom,mdss-dsi-panel-height = <0x780>;
						qcom,mdss-dsi-panel-timings = <0xe6382600 0x686e2a3c 0x44030400>;
						qcom,mdss-dsi-panel-width = <0x438>;
						qcom,mdss-dsi-v-back-porch = <0x2>;
						qcom,mdss-dsi-v-bottom-border = <0x0>;
						qcom,mdss-dsi-v-front-porch = <0xc>;
						qcom,mdss-dsi-v-pulse-width = <0x2>;
						qcom,mdss-dsi-v-top-border = <0x0>;
					};
				};
			};
		};
	};

	fragment@24 {
		target = <0xffffffff>;

		__overlay__ {

			qcom,mdss_dsi_nt35695b_truly_fhd_cmd {
				phandle = <0x15>;
				qcom,mdss-dsi-bl-max-level = <0xfff>;
				qcom,mdss-dsi-bl-min-level = <0x1>;
				qcom,mdss-dsi-bl-pmic-control-type = "bl_ctrl_wled";
				qcom,mdss-dsi-bllp-eof-power-mode;
				qcom,mdss-dsi-bllp-power-mode;
				qcom,mdss-dsi-border-color = <0x0>;
				qcom,mdss-dsi-bpp = <0x18>;
				qcom,mdss-dsi-dma-trigger = "trigger_sw";
				qcom,mdss-dsi-lane-0-state;
				qcom,mdss-dsi-lane-1-state;
				qcom,mdss-dsi-lane-2-state;
				qcom,mdss-dsi-lane-3-state;
				qcom,mdss-dsi-mdp-trigger = "none";
				qcom,mdss-dsi-panel-name = "nt35695b truly fhd command mode dsi panel";
				qcom,mdss-dsi-panel-type = "dsi_cmd_mode";
				qcom,mdss-dsi-post-init-delay = <0x1>;
				qcom,mdss-dsi-reset-sequence = <0x1 0xa 0x0 0xa 0x1 0xa>;
				qcom,mdss-dsi-stream = <0x0>;
				qcom,mdss-dsi-t-clk-post = <0xd>;
				qcom,mdss-dsi-t-clk-pre = <0x2f>;
				qcom,mdss-dsi-te-check-enable;
				qcom,mdss-dsi-te-dcs-command = <0x1>;
				qcom,mdss-dsi-te-pin-select = <0x1>;
				qcom,mdss-dsi-te-using-te-pin;
				qcom,mdss-dsi-traffic-mode = "burst_mode";
				qcom,mdss-dsi-tx-eot-append;
				qcom,mdss-dsi-underflow-color = <0xff>;
				qcom,mdss-dsi-virtual-channel-id = <0x0>;
				qcom,ulps-enabled;

				qcom,mdss-dsi-display-timings {

					timing@0 {
						qcom,mdss-dsi-h-back-porch = <0x3c>;
						qcom,mdss-dsi-h-front-porch = <0x78>;
						qcom,mdss-dsi-h-left-border = <0x0>;
						qcom,mdss-dsi-h-pulse-width = <0xc>;
						qcom,mdss-dsi-h-right-border = <0x0>;
						qcom,mdss-dsi-h-sync-pulse = <0x0>;
						qcom,mdss-dsi-h-sync-skew = <0x0>;
						qcom,mdss-dsi-off-command = [05 01 00 00 14 00 02 28 00 05 01 00 00 78 00 02 10 00];
						qcom,mdss-dsi-off-command-state = "dsi_lp_mode";
						qcom,mdss-dsi-on-command = [15 01 00 00 10 00 02 ff 20 15 01 00 00 00 00 02 fb 01 15 01 00 00 00 00 02 00 01 15 01 00 00 00 00 02 01 55 15 01 00 00 00 00 02 02 45 15 01 00 00 00 00 02 03 55 15 01 00 00 00 00 02 05 50 15 01 00 00 00 00 02 06 a8 15 01 00 00 00 00 02 07 ad 15 01 00 00 00 00 02 08 0c 15 01 00 00 00 00 02 0b aa 15 01 00 00 00 00 02 0c aa 15 01 00 00 00 00 02 0e b0 15 01 00 00 00 00 02 0f b3 15 01 00 00 00 00 02 11 28 15 01 00 00 00 00 02 12 10 15 01 00 00 00 00 02 13 01 15 01 00 00 00 00 02 14 4a 15 01 00 00 00 00 02 15 12 15 01 00 00 00 00 02 16 12 15 01 00 00 00 00 02 30 01 15 01 00 00 00 00 02 72 11 15 01 00 00 00 00 02 58 82 15 01 00 00 00 00 02 59 00 15 01 00 00 00 00 02 5a 02 15 01 00 00 00 00 02 5b 00 15 01 00 00 00 00 02 5c 82 15 01 00 00 00 00 02 5d 80 15 01 00 00 00 00 02 5e 02 15 01 00 00 00 00 02 5f 00 15 01 00 00 00 00 02 ff 24 15 01 00 00 00 00 02 fb 01 15 01 00 00 00 00 02 00 01 15 01 00 00 00 00 02 01 0b 15 01 00 00 00 00 02 02 0c 15 01 00 00 00 00 02 03 89 15 01 00 00 00 00 02 04 8a 15 01 00 00 00 00 02 05 0f 15 01 00 00 00 00 02 06 10 15 01 00 00 00 00 02 07 10 15 01 00 00 00 00 02 08 1c 15 01 00 00 00 00 02 09 00 15 01 00 00 00 00 02 0a 00 15 01 00 00 00 00 02 0b 00 15 01 00 00 00 00 02 0c 00 15 01 00 00 00 00 02 0d 13 15 01 00 00 00 00 02 0e 15 15 01 00 00 00 00 02 0f 17 15 01 00 00 00 00 02 10 01 15 01 00 00 00 00 02 11 0b 15 01 00 00 00 00 02 12 0c 15 01 00 00 00 00 02 13 89 15 01 00 00 00 00 02 14 8a 15 01 00 00 00 00 02 15 0f 15 01 00 00 00 00 02 16 10 15 01 00 00 00 00 02 17 10 15 01 00 00 00 00 02 18 1c 15 01 00 00 00 00 02 19 00 15 01 00 00 00 00 02 1a 00 15 01 00 00 00 00 02 1b 00 15 01 00 00 00 00 02 1c 00 15 01 00 00 00 00 02 1d 13 15 01 00 00 00 00 02 1e 15 15 01 00 00 00 00 02 1f 17 15 01 00 00 00 00 02 20 00 15 01 00 00 00 00 02 21 01 15 01 00 00 00 00 02 22 00 15 01 00 00 00 00 02 23 40 15 01 00 00 00 00 02 24 40 15 01 00 00 00 00 02 25 6d 15 01 00 00 00 00 02 26 40 15 01 00 00 00 00 02 27 40 15 01 00 00 00 00 02 29 d8 15 01 00 00 00 00 02 2a 2a 15 01 00 00 00 00 02 4b 03 15 01 00 00 00 00 02 4c 11 15 01 00 00 00 00 02 4d 10 15 01 00 00 00 00 02 4e 01 15 01 00 00 00 00 02 4f 01 15 01 00 00 00 00 02 50 10 15 01 00 00 00 00 02 51 00 15 01 00 00 00 00 02 52 80 15 01 00 00 00 00 02 53 00 15 01 00 00 00 00 02 54 07 15 01 00 00 00 00 02 55 25 15 01 00 00 00 00 02 56 00 15 01 00 00 00 00 02 58 07 15 01 00 00 00 00 02 5b 43 15 01 00 00 00 00 02 5c 00 15 01 00 00 00 00 02 5f 73 15 01 00 00 00 00 02 60 73 15 01 00 00 00 00 02 63 22 15 01 00 00 00 00 02 64 00 15 01 00 00 00 00 02 67 08 15 01 00 00 00 00 02 68 04 15 01 00 00 00 00 02 7a 80 15 01 00 00 00 00 02 7b 91 15 01 00 00 00 00 02 7c d8 15 01 00 00 00 00 02 7d 60 15 01 00 00 00 00 02 93 06 15 01 00 00 00 00 02 94 06 15 01 00 00 00 00 02 8a 00 15 01 00 00 00 00 02 9b 0f 15 01 00 00 00 00 02 b3 c0 15 01 00 00 00 00 02 b4 00 15 01 00 00 00 00 02 b5 00 15 01 00 00 00 00 02 b6 21 15 01 00 00 00 00 02 b7 22 15 01 00 00 00 00 02 b8 07 15 01 00 00 00 00 02 b9 07 15 01 00 00 00 00 02 ba 22 15 01 00 00 00 00 02 bd 20 15 01 00 00 00 00 02 be 07 15 01 00 00 00 00 02 bf 07 15 01 00 00 00 00 02 c1 6d 15 01 00 00 00 00 02 c4 24 15 01 00 00 00 00 02 e3 00 15 01 00 00 00 00 02 ec 00 15 01 00 00 00 00 02 ff 10 15 01 00 00 00 00 02 bb 10 15 01 00 00 00 00 02 35 00 05 01 00 00 78 00 02 11 00 05 01 00 00 78 00 02 29 00];
						qcom,mdss-dsi-on-command-state = "dsi_lp_mode";
						qcom,mdss-dsi-panel-framerate = <0x3c>;
						qcom,mdss-dsi-panel-height = <0x780>;
						qcom,mdss-dsi-panel-timings = <0xe6382600 0x686e2a3c 0x44030400>;
						qcom,mdss-dsi-panel-width = <0x438>;
						qcom,mdss-dsi-v-back-porch = <0x2>;
						qcom,mdss-dsi-v-bottom-border = <0x0>;
						qcom,mdss-dsi-v-front-porch = <0xc>;
						qcom,mdss-dsi-v-pulse-width = <0x2>;
						qcom,mdss-dsi-v-top-border = <0x0>;
					};
				};
			};
		};
	};

	fragment@25 {
		target = <0xffffffff>;

		__overlay__ {

			qcom,mdss_dsi_icn9706_720_1440p_video {
				phandle = <0x16>;
				qcom,esd-check-enabled;
				qcom,mdss-dsi-bl-max-level = <0xfff>;
				qcom,mdss-dsi-bl-min-level = <0x1>;
				qcom,mdss-dsi-bl-pmic-control-type = "bl_ctrl_wled";
				qcom,mdss-dsi-bllp-eof-power-mode;
				qcom,mdss-dsi-bllp-power-mode;
				qcom,mdss-dsi-border-color = <0x0>;
				qcom,mdss-dsi-bpp = <0x18>;
				qcom,mdss-dsi-dma-trigger = "trigger_sw";
				qcom,mdss-dsi-h-back-porch = <0x54>;
				qcom,mdss-dsi-h-front-porch = <0x54>;
				qcom,mdss-dsi-h-left-border = <0x0>;
				qcom,mdss-dsi-h-pulse-width = <0x18>;
				qcom,mdss-dsi-h-right-border = <0x0>;
				qcom,mdss-dsi-h-sync-pulse = <0x1>;
				qcom,mdss-dsi-h-sync-skew = <0x0>;
				qcom,mdss-dsi-lane-0-state;
				qcom,mdss-dsi-lane-1-state;
				qcom,mdss-dsi-lane-2-state;
				qcom,mdss-dsi-lane-3-state;
				qcom,mdss-dsi-lane-map = "lane_map_0123";
				qcom,mdss-dsi-mdp-trigger = "none";
				qcom,mdss-dsi-off-command = [05 01 00 00 32 00 02 28 00 05 01 00 00 32 00 02 10 00];
				qcom,mdss-dsi-off-command-state = "dsi_lp_mode";
				qcom,mdss-dsi-on-command = <0x39010000 0x64000201 0x390100 0x3 0xf05a5a39 0x1000000 0x3f15a 0x5a390100 0x3 0xf0b44b39 0x1000000 0x3b610 0x10390100 0x15 0xb40a0812 0x100e0c00 0x300 0x3030303 0x3030304 0x6390100 0x15 0xb30b0913 0x110f0d00 0x300 0x3030303 0x3030305 0x7390100 0xd 0xb0543223 0x45444444 0x44600160 0x1390100 0x9 0xb1328402 0x83150157 0x1390100 0x2 0xb2333901 0x0 0x7bd5414 0x6a6a2019 0x39010000 0x12b7 0x1010911 0xd15190d 0x211d0000 0x200002ff 0x3c390100 0x6 0xb8230130 0x34533901 0x0 0x5b9a12c 0xffc43901 0x0 0x3ba8823 0x39010000 0x7c1 0x1616040c 0x10043901 0x0 0x3c21268 0x39010000 0x4c3 0x22310439 0x1000000 0x6c705 0x236b4100 0x39010000 0x27c8 0x7c543d2d 0x26161b08 0x25282d4f 0x3e483d3d 0x3525067c 0x543d2d26 0x161b0825 0x282d4f3e 0x483d3d35 0x25063901 0x0 0x9c60000 0x68000060 0x36000501 0x6400 0x2110005 0x1000032 0x22900>;
				qcom,mdss-dsi-on-command-state = "dsi_lp_mode";
				qcom,mdss-dsi-panel-controller = <0xffffffff>;
				qcom,mdss-dsi-panel-destination = "display_1";
				qcom,mdss-dsi-panel-framerate = <0x3c>;
				qcom,mdss-dsi-panel-height = <0x5a0>;
				qcom,mdss-dsi-panel-name = "icn9706 720 1440p video mode dsi panel";
				qcom,mdss-dsi-panel-status-check-mode = "bta_check";
				qcom,mdss-dsi-panel-timings = <0x8b1e1400 0x44481822 0x19030400>;
				qcom,mdss-dsi-panel-type = "dsi_video_mode";
				qcom,mdss-dsi-panel-width = <0x2d0>;
				qcom,mdss-dsi-reset-sequence = <0x1 0x2 0x0 0x14 0x1 0x32>;
				qcom,mdss-dsi-stream = <0x0>;
				qcom,mdss-dsi-t-clk-post = <0x4>;
				qcom,mdss-dsi-t-clk-pre = <0x1c>;
				qcom,mdss-dsi-traffic-mode = "burst_mode";
				qcom,mdss-dsi-tx-eot-append;
				qcom,mdss-dsi-underflow-color = <0xff>;
				qcom,mdss-dsi-v-back-porch = <0x14>;
				qcom,mdss-dsi-v-bottom-border = <0x0>;
				qcom,mdss-dsi-v-front-porch = <0x18>;
				qcom,mdss-dsi-v-pulse-width = <0x8>;
				qcom,mdss-dsi-v-top-border = <0x0>;
				qcom,mdss-dsi-virtual-channel-id = <0x0>;
				qcom,mdss-pan-physical-height-dimension = <0x70>;
				qcom,mdss-pan-physical-width-dimension = <0x3f>;
			};
		};
	};

	fragment@26 {
		target = <0xffffffff>;

		__overlay__ {

			qcom,mdss_dsi_edo_rm67162_qvga_cmd {
				phandle = <0x17>;
				qcom,mdss-dsi-bl-max-level = <0xff>;
				qcom,mdss-dsi-bl-min-level = <0x1>;
				qcom,mdss-dsi-bl-pmic-control-type = "bl_ctrl_wled";
				qcom,mdss-dsi-bllp-eof-power-mode;
				qcom,mdss-dsi-bllp-power-mode;
				qcom,mdss-dsi-border-color = <0x0>;
				qcom,mdss-dsi-bpp = <0x18>;
				qcom,mdss-dsi-color-order = "rgb_swap_rgb";
				qcom,mdss-dsi-dma-trigger = "trigger_sw";
				qcom,mdss-dsi-h-back-porch = <0xa4>;
				qcom,mdss-dsi-h-front-porch = <0x8c>;
				qcom,mdss-dsi-h-left-border = <0x0>;
				qcom,mdss-dsi-h-pulse-width = <0x8>;
				qcom,mdss-dsi-h-right-border = <0x0>;
				qcom,mdss-dsi-h-sync-pulse = <0x1>;
				qcom,mdss-dsi-h-sync-skew = <0x0>;
				qcom,mdss-dsi-idle-off-command = <0x5010000 0x138>;
				qcom,mdss-dsi-idle-off-command-state = "dsi_lp_mode";
				qcom,mdss-dsi-idle-on-command = [15 01 00 00 00 00 02 fe 00 05 01 00 00 00 00 01 39];
				qcom,mdss-dsi-idle-on-command-state = "dsi_hs_mode";
				qcom,mdss-dsi-lane-0-state;
				qcom,mdss-dsi-lane-map = "lane_map_0123";
				qcom,mdss-dsi-mdp-trigger = "none";
				qcom,mdss-dsi-off-command = <0x5010000 0x5000251 0x50100 0x140002 0x28000501 0x7800 0x2100005 0x1000014 0x24f01>;
				qcom,mdss-dsi-off-command-state = "dsi_hs_mode";
				qcom,mdss-dsi-on-command = [29 01 00 00 00 00 02 fe 0a 29 01 00 00 00 00 02 29 90 29 01 00 00 00 00 02 fe 05 29 01 00 00 00 00 02 05 00 29 01 00 00 00 00 02 fe 00 29 01 00 00 00 00 02 35 00 29 01 00 00 00 00 02 51 80 29 01 00 00 00 00 02 53 20 29 01 00 00 78 00 02 11 00 29 01 00 00 05 00 02 29 00];
				qcom,mdss-dsi-on-command-state = "dsi_lp_mode";
				qcom,mdss-dsi-panel-controller = <0xffffffff>;
				qcom,mdss-dsi-panel-destination = "display_1";
				qcom,mdss-dsi-panel-framerate = <0x3c>;
				qcom,mdss-dsi-panel-height = <0x168>;
				qcom,mdss-dsi-panel-name = "rm67162 qvga cmd mode dsi panel";
				qcom,mdss-dsi-panel-timings = <0x7d251d00 0x37332227 0x1e030400>;
				qcom,mdss-dsi-panel-type = "dsi_cmd_mode";
				qcom,mdss-dsi-panel-width = <0x140>;
				qcom,mdss-dsi-pixel-alignment = <0x0>;
				qcom,mdss-dsi-pixel-packing = "tight";
				qcom,mdss-dsi-reset-sequence = <0x1 0x1 0x0 0xc 0x1 0xc>;
				qcom,mdss-dsi-stream = <0x0>;
				qcom,mdss-dsi-t-clk-post = <0x9>;
				qcom,mdss-dsi-t-clk-pre = <0x2c>;
				qcom,mdss-dsi-te-check-enable;
				qcom,mdss-dsi-te-dcs-command = <0x1>;
				qcom,mdss-dsi-te-pin-select = <0x1>;
				qcom,mdss-dsi-te-using-te-pin;
				qcom,mdss-dsi-te-v-sync-rd-ptr-irq-line = <0x2c>;
				qcom,mdss-dsi-traffic-mode = "burst_mode";
				qcom,mdss-dsi-underflow-color = <0xff>;
				qcom,mdss-dsi-v-back-porch = <0x1>;
				qcom,mdss-dsi-v-bottom-border = <0x0>;
				qcom,mdss-dsi-v-front-porch = <0x6>;
				qcom,mdss-dsi-v-pulse-width = <0x1>;
				qcom,mdss-dsi-v-top-border = <0x0>;
				qcom,mdss-dsi-virtual-channel-id = <0x0>;
			};
		};
	};

	fragment@27 {
		target = <0xffffffff>;

		__overlay__ {

			qcom,mdss_dsi_boe_icnl9706_800p_video {
				phandle = <0x18>;
				qcom,esd-check-enabled;
				qcom,mdss-dsi-bl-dcs-command-state = "dsi_lp_mode";
				qcom,mdss-dsi-bl-max-level = <0xff>;
				qcom,mdss-dsi-bl-min-level = <0x1>;
				qcom,mdss-dsi-bl-pmic-control-type = "bl_ctrl_dcs";
				qcom,mdss-dsi-bllp-eof-power-mode;
				qcom,mdss-dsi-bllp-power-mode;
				qcom,mdss-dsi-border-color = <0x0>;
				qcom,mdss-dsi-bpp = <0x18>;
				qcom,mdss-dsi-dma-trigger = "trigger_sw";
				qcom,mdss-dsi-h-back-porch = <0x69>;
				qcom,mdss-dsi-h-front-porch = <0xb4>;
				qcom,mdss-dsi-h-left-border = <0x0>;
				qcom,mdss-dsi-h-pulse-width = <0x4>;
				qcom,mdss-dsi-h-right-border = <0x0>;
				qcom,mdss-dsi-h-sync-pulse = <0x0>;
				qcom,mdss-dsi-h-sync-skew = <0x0>;
				qcom,mdss-dsi-hfp-power-mode;
				qcom,mdss-dsi-hsa-power-mode;
				qcom,mdss-dsi-lane-0-state;
				qcom,mdss-dsi-lane-1-state;
				qcom,mdss-dsi-lane-2-state;
				qcom,mdss-dsi-lane-3-state;
				qcom,mdss-dsi-lane-map = "lane_map_0123";
				qcom,mdss-dsi-lp11-init;
				qcom,mdss-dsi-mdp-trigger = "none";
				qcom,mdss-dsi-off-command = [15 01 00 00 00 00 02 53 2c 15 01 00 00 00 00 02 51 00 15 01 00 00 00 00 02 55 10 05 01 00 00 14 00 02 28 00 05 01 00 00 78 00 02 10 00];
				qcom,mdss-dsi-off-command-state = "dsi_lp_mode";
				qcom,mdss-dsi-on-command = [39 01 00 00 00 00 03 f0 5a 5a 39 01 00 00 00 00 03 f1 a5 a5 39 01 00 00 00 00 05 d2 63 0a 08 98 39 01 00 00 00 00 05 e0 12 55 01 17 39 01 00 00 00 00 1b e1 ff ff ff ff ff ff ff ff ff ff ff ff ff ff ff ff ff ff ff ff ff ff ff ff ff ff 39 01 00 00 00 00 03 f6 00 05 15 01 00 00 00 00 02 53 2c 15 01 00 00 00 00 02 51 00 15 01 00 00 00 00 02 55 10 05 01 00 00 78 00 02 11 00 05 01 00 00 14 00 02 29 00];
				qcom,mdss-dsi-on-command-state = "dsi_lp_mode";
				qcom,mdss-dsi-panel-controller = <0xffffffff>;
				qcom,mdss-dsi-panel-destination = "display_1";
				qcom,mdss-dsi-panel-framerate = <0x3c>;
				qcom,mdss-dsi-panel-height = <0x500>;
				qcom,mdss-dsi-panel-max-error-count = <0x3>;
				qcom,mdss-dsi-panel-name = "boe icnl9706 800p video mode dsi panel";
				qcom,mdss-dsi-panel-on-check-value = <0x9c>;
				qcom,mdss-dsi-panel-status-check-mode = "reg_read";
				qcom,mdss-dsi-panel-status-command = <0x6010001 0x500010a>;
				qcom,mdss-dsi-panel-status-command-state = "dsi_lp_mode";
				qcom,mdss-dsi-panel-status-read-length = <0x3>;
				qcom,mdss-dsi-panel-status-valid-params = <0x1>;
				qcom,mdss-dsi-panel-status-value = <0x9c>;
				qcom,mdss-dsi-panel-timings-phy-12nm = <0xb070a03 0x50304>;
				qcom,mdss-dsi-panel-type = "dsi_video_mode";
				qcom,mdss-dsi-panel-width = <0x320>;
				qcom,mdss-dsi-post-init-delay = <0x1>;
				qcom,mdss-dsi-reset-sequence = <0x1 0xa 0x0 0xa 0x1 0xa>;
				qcom,mdss-dsi-stream = <0x0>;
				qcom,mdss-dsi-t-clk-post = <0x10>;
				qcom,mdss-dsi-t-clk-pre = <0x27>;
				qcom,mdss-dsi-traffic-mode = "burst_mode";
				qcom,mdss-dsi-tx-eot-append;
				qcom,mdss-dsi-underflow-color = <0xff>;
				qcom,mdss-dsi-v-back-porch = <0xc>;
				qcom,mdss-dsi-v-bottom-border = <0x0>;
				qcom,mdss-dsi-v-front-porch = <0x10>;
				qcom,mdss-dsi-v-pulse-width = <0x4>;
				qcom,mdss-dsi-v-top-border = <0x0>;
				qcom,mdss-dsi-virtual-channel-id = <0x0>;
				qcom,mdss-pan-physical-height-dimension = <0xd9>;
				qcom,mdss-pan-physical-width-dimension = <0x87>;
			};
		};
	};

	fragment@28 {
		target = <0xffffffff>;

		__overlay__ {

			qcom,mdss_dsi_inx_jd9365_800p_video {
				phandle = <0x19>;
				qcom,esd-check-enabled;
				qcom,mdss-dsi-bl-dcs-command-state = "dsi_lp_mode";
				qcom,mdss-dsi-bl-max-level = <0xff>;
				qcom,mdss-dsi-bl-min-level = <0x1>;
				qcom,mdss-dsi-bl-pmic-control-type = "bl_ctrl_dcs";
				qcom,mdss-dsi-bllp-eof-power-mode;
				qcom,mdss-dsi-bllp-power-mode;
				qcom,mdss-dsi-border-color = <0x0>;
				qcom,mdss-dsi-bpp = <0x18>;
				qcom,mdss-dsi-dma-trigger = "trigger_sw";
				qcom,mdss-dsi-h-back-porch = <0x64>;
				qcom,mdss-dsi-h-front-porch = <0x43>;
				qcom,mdss-dsi-h-left-border = <0x0>;
				qcom,mdss-dsi-h-pulse-width = <0x64>;
				qcom,mdss-dsi-h-right-border = <0x0>;
				qcom,mdss-dsi-h-sync-pulse = <0x0>;
				qcom,mdss-dsi-h-sync-skew = <0x0>;
				qcom,mdss-dsi-lane-0-state;
				qcom,mdss-dsi-lane-1-state;
				qcom,mdss-dsi-lane-2-state;
				qcom,mdss-dsi-lane-3-state;
				qcom,mdss-dsi-lane-map = "lane_map_0123";
				qcom,mdss-dsi-lp11-init;
				qcom,mdss-dsi-mdp-trigger = "none";
				qcom,mdss-dsi-off-command = [15 01 00 00 00 00 02 53 24 15 01 00 00 00 00 02 51 00 15 01 00 00 00 00 02 55 10 05 01 00 00 14 00 02 28 00 05 01 00 00 78 00 02 10 00];
				qcom,mdss-dsi-off-command-state = "dsi_lp_mode";
				qcom,mdss-dsi-on-command = <0x5010000 0x78000211 0x150100 0x2 0xe0001501 0x0 0x2e19315 0x1000000 0x2e265 0x15010000 0x2e3 0xf8150100 0x2 0x80031501 0x0 0x2e00315 0x1000000 0x2a033 0x15010000 0x2a1 0x11150100 0x2 0xe0011501 0x0 0x2371515 0x1000000 0x2e000 0x5010000 0xa000229 0x150100 0x2 0x51001501 0x0 0x2532c15 0x1000000 0x25500>;
				qcom,mdss-dsi-on-command-state = "dsi_lp_mode";
				qcom,mdss-dsi-panel-controller = <0xffffffff>;
				qcom,mdss-dsi-panel-destination = "display_1";
				qcom,mdss-dsi-panel-framerate = <0x3c>;
				qcom,mdss-dsi-panel-height = <0x500>;
				qcom,mdss-dsi-panel-max-error-count = <0x3>;
				qcom,mdss-dsi-panel-name = "inx jd9365 800p video mode dsi panel";
				qcom,mdss-dsi-panel-on-check-value = <0x9c>;
				qcom,mdss-dsi-panel-status-check-mode = "reg_read";
				qcom,mdss-dsi-panel-status-command = <0x6010001 0x500010a>;
				qcom,mdss-dsi-panel-status-command-state = "dsi_lp_mode";
				qcom,mdss-dsi-panel-status-read-length = <0x3>;
				qcom,mdss-dsi-panel-status-valid-params = <0x1>;
				qcom,mdss-dsi-panel-status-value = <0x9c>;
				qcom,mdss-dsi-panel-timings-phy-12nm = <0xb070a03 0x50304>;
				qcom,mdss-dsi-panel-type = "dsi_video_mode";
				qcom,mdss-dsi-panel-width = <0x320>;
				qcom,mdss-dsi-post-init-delay = <0x1>;
				qcom,mdss-dsi-reset-sequence = <0x1 0xa 0x0 0xa 0x1 0xa>;
				qcom,mdss-dsi-stream = <0x0>;
				qcom,mdss-dsi-t-clk-post = <0x10>;
				qcom,mdss-dsi-traffic-mode = "burst_mode";
				qcom,mdss-dsi-tx-eot-append;
				qcom,mdss-dsi-underflow-color = <0xff>;
				qcom,mdss-dsi-v-back-porch = <0x8>;
				qcom,mdss-dsi-v-bottom-border = <0x0>;
				qcom,mdss-dsi-v-front-porch = <0x32>;
				qcom,mdss-dsi-v-pulse-width = <0x4>;
				qcom,mdss-dsi-v-top-border = <0x0>;
				qcom,mdss-dsi-virtual-channel-id = <0x0>;
				qcom,mdss-pan-physical-height-dimension = <0xd9>;
				qcom,mdss-pan-physical-width-dimension = <0x87>;
			};
		};
	};

	fragment@29 {
		target = <0xffffffff>;

		__overlay__ {

			qcom,mdss_dsi_inx_ili9881c_800p_video {
				phandle = <0x1a>;
				qcom,mdss-dsi-bl-dcs-command-state = "dsi_lp_mode";
				qcom,mdss-dsi-bl-max-level = <0xfff>;
				qcom,mdss-dsi-bl-min-level = <0x1>;
				qcom,mdss-dsi-bl-pmic-control-type = "bl_ctrl_dcs";
				qcom,mdss-dsi-bllp-eof-power-mode;
				qcom,mdss-dsi-bllp-power-mode;
				qcom,mdss-dsi-border-color = <0x0>;
				qcom,mdss-dsi-bpp = <0x18>;
				qcom,mdss-dsi-dma-trigger = "trigger_sw";
				qcom,mdss-dsi-h-back-porch = <0x2e>;
				qcom,mdss-dsi-h-front-porch = <0x2e>;
				qcom,mdss-dsi-h-left-border = <0x0>;
				qcom,mdss-dsi-h-pulse-width = <0xc>;
				qcom,mdss-dsi-h-right-border = <0x0>;
				qcom,mdss-dsi-h-sync-pulse = <0x0>;
				qcom,mdss-dsi-h-sync-skew = <0x0>;
				qcom,mdss-dsi-lane-0-state;
				qcom,mdss-dsi-lane-1-state;
				qcom,mdss-dsi-lane-2-state;
				qcom,mdss-dsi-lane-3-state;
				qcom,mdss-dsi-lane-map = "lane_map_0123";
				qcom,mdss-dsi-lp11-init;
				qcom,mdss-dsi-mdp-trigger = "none";
				qcom,mdss-dsi-off-command = [05 01 00 00 14 00 02 28 00 05 01 00 00 78 00 02 10 00];
				qcom,mdss-dsi-off-command-state = "dsi_lp_mode";
				qcom,mdss-dsi-on-command = <0x39010000 0x4ff 0x98810315 0x1000000 0x20100 0x15010000 0x202 0x150100 0x2 0x3531501 0x0 0x2045315 0x1000000 0x20513 0x15010000 0x206 0x4150100 0x2 0x7021501 0x0 0x2080215 0x1000000 0x20900 0x15010000 0x20a 0x150100 0x2 0xb001501 0x0 0x20c0015 0x1000000 0x20d00 0x15010000 0x20e 0x150100 0x2 0xf001501 0x0 0x2100015 0x1000000 0x21100 0x15010000 0x212 0x150100 0x2 0x13001501 0x0 0x2140015 0x1000000 0x21500 0x15010000 0x216 0x150100 0x2 0x17001501 0x0 0x2180015 0x1000000 0x21900 0x15010000 0x21a 0x150100 0x2 0x1b001501 0x0 0x21c0015 0x1000000 0x21d00 0x15010000 0x21e 0xc0150100 0x2 0x1f801501 0x0 0x2200215 0x1000000 0x22109 0x15010000 0x222 0x150100 0x2 0x23001501 0x0 0x2240015 0x1000000 0x22500 0x15010000 0x226 0x150100 0x2 0x27001501 0x0 0x2285515 0x1000000 0x22903 0x15010000 0x22a 0x150100 0x2 0x2b001501 0x0 0x22c0015 0x1000000 0x22d00 0x15010000 0x22e 0x150100 0x2 0x2f001501 0x0 0x2300015 0x1000000 0x23100 0x15010000 0x232 0x150100 0x2 0x33001501 0x0 0x2340015 0x1000000 0x23500 0x15010000 0x236 0x150100 0x2 0x37001501 0x0 0x2383c15 0x1000000 0x23900 0x15010000 0x23a 0x150100 0x2 0x3b001501 0x0 0x23c0015 0x1000000 0x23d00 0x15010000 0x23e 0x150100 0x2 0x3f001501 0x0 0x2406015 0x1000000 0x24100 0x15010000 0x242 0x150100 0x2 0x43001501 0x0 0x2440015 0x1000000 0x25001 0x15010000 0x251 0x23150100 0x2 0x52451501 0x0 0x2536715 0x1000000 0x25489 0x15010000 0x255 0xab150100 0x2 0x56011501 0x0 0x2572315 0x1000000 0x25845 0x15010000 0x259 0x67150100 0x2 0x5a891501 0x0 0x25bab15 0x1000000 0x25ccd 0x15010000 0x25d 0xef150100 0x2 0x5e011501 0x0 0x25f0a15 0x1000000 0x26002 0x15010000 0x261 0x2150100 0x2 0x62081501 0x0 0x2631515 0x1000000 0x26414 0x15010000 0x265 0x2150100 0x2 0x66111501 0x0 0x2671015 0x1000000 0x26802 0x15010000 0x269 0xf150100 0x2 0x6a0e1501 0x0 0x26b0215 0x1000000 0x26c0d 0x15010000 0x26d 0xc150100 0x2 0x6e061501 0x0 0x26f0215 0x1000000 0x27002 0x15010000 0x271 0x2150100 0x2 0x72021501 0x0 0x2730215 0x1000000 0x27402 0x15010000 0x275 0xa150100 0x2 0x76021501 0x0 0x2770215 0x1000000 0x27806 0x15010000 0x279 0x15150100 0x2 0x7a141501 0x0 0x27b0215 0x1000000 0x27c10 0x15010000 0x27d 0x11150100 0x2 0x7e021501 0x0 0x27f0c15 0x1000000 0x2800d 0x15010000 0x281 0x2150100 0x2 0x820e1501 0x0 0x2830f15 0x1000000 0x28408 0x15010000 0x285 0x2150100 0x2 0x86021501 0x0 0x2870215 0x1000000 0x28802 0x15010000 0x289 0x2150100 0x2 0x8a023901 0x0 0x4ff9881 0x4150100 0x2 0x6c151501 0x0 0x26e3015 0x1000000 0x26f47 0x15010000 0x28d 0x1f150100 0x2 0x87ba1501 0x0 0x2267615 0x1000000 0x2b2d1 0x15010000 0x2b5 0x7150100 0x2 0x35171501 0x0 0x2331415 0x1000000 0x23175 0x15010000 0x23a 0x85150100 0x2 0x3b981501 0x0 0x2380115 0x1000000 0x23900 0x15010000 0x27a 0x10150100 0x2 0x4c021501 0x0 0x2523715 0x1000000 0x25337 0x15010000 0x254 0x46390100 0x4 0xff988101 0x15010000 0x222 0xa150100 0x2 0x31091501 0x0 0x2509e15 0x1000000 0x25199 0x15010000 0x260 0x28150100 0x2 0x2ec81501 0x0 0x2340115 0x1000000 0x24365 0x15010000 0x2a0 0x150100 0x2 0xa1171501 0x0 0x2a22515 0x1000000 0x2a313 0x15010000 0x2a4 0x17150100 0x2 0xa5291501 0x0 0x2a61d15 0x1000000 0x2a71f 0x15010000 0x2a8 0x7c150100 0x2 0xa91c1501 0x0 0x2aa2815 0x1000000 0x2ab6e 0x15010000 0x2ac 0x1a150100 0x2 0xad161501 0x0 0x2ae4915 0x1000000 0x2af1f 0x15010000 0x2b0 0x26150100 0x2 0xb14b1501 0x0 0x2b25c15 0x1000000 0x2b32a 0x15010000 0x2c0 0x150100 0x2 0xc1171501 0x0 0x2c22515 0x1000000 0x2c313 0x15010000 0x2c4 0x17150100 0x2 0xc5291501 0x0 0x2c61d15 0x1000000 0x2c71f 0x15010000 0x2c8 0x7c150100 0x2 0xc91c1501 0x0 0x2ca2815 0x1000000 0x2cb6e 0x15010000 0x2cc 0x1a150100 0x2 0xcd161501 0x0 0x2ce4915 0x1000000 0x2cf1f 0x15010000 0x2d0 0x26150100 0x2 0xd14b1501 0x0 0x2d25c15 0x1000000 0x2d32a 0x39010000 0x4ff 0x98810215 0x1000000 0x20610 0x15010000 0x78000207 0x390100 0x4 0xff988100 0x15010000 0x253 0x2c150100 0x2 0x55003901 0x0 0x3680401 0x15010000 0x235 0x150100 0x3c0002 0x11001501 0x0 0x2360015 0x100000a 0x22900>;
				qcom,mdss-dsi-on-command-state = "dsi_lp_mode";
				qcom,mdss-dsi-panel-controller = <0xffffffff>;
				qcom,mdss-dsi-panel-destination = "display_1";
				qcom,mdss-dsi-panel-framerate = <0x3c>;
				qcom,mdss-dsi-panel-height = <0x500>;
				qcom,mdss-dsi-panel-name = "inx ili9881c 800p video mode dsi panel";
				qcom,mdss-dsi-panel-orientation = "180";
				qcom,mdss-dsi-panel-timings-phy-12nm = <0x1b0b0c07 0x509070b>;
				qcom,mdss-dsi-panel-type = "dsi_video_mode";
				qcom,mdss-dsi-panel-width = <0x320>;
				qcom,mdss-dsi-post-init-delay = <0x1>;
				qcom,mdss-dsi-reset-sequence = <0x1 0x1 0x0 0x1 0x1 0xa>;
				qcom,mdss-dsi-stream = <0x0>;
				qcom,mdss-dsi-t-clk-post = <0x12>;
				qcom,mdss-dsi-t-clk-pre = <0x4>;
				qcom,mdss-dsi-traffic-mode = "burst_mode";
				qcom,mdss-dsi-tx-eot-append;
				qcom,mdss-dsi-underflow-color = <0xff>;
				qcom,mdss-dsi-v-back-porch = <0xe>;
				qcom,mdss-dsi-v-bottom-border = <0x0>;
				qcom,mdss-dsi-v-front-porch = <0x14>;
				qcom,mdss-dsi-v-pulse-width = <0x2>;
				qcom,mdss-dsi-v-top-border = <0x0>;
				qcom,mdss-dsi-virtual-channel-id = <0x0>;
				qcom,mdss-pan-physical-height-dimension = <0xd9>;
				qcom,mdss-pan-physical-width-dimension = <0x87>;
			};
		};
	};

	fragment@3 {
		target = <0xffffffff>;

		__overlay__ {
			qcom,batt-aging-comp;
			qcom,battery-data = <0xffffffff>;
			qcom,resume-soc = <0x63>;
			status = "ok";
		};
	};

	fragment@30 {
		target = <0xffffffff>;

		__overlay__ {

			qcom,mdss_dsi_hx8252_800p_video {
				phandle = <0x1b>;
				qcom,esd-check-enabled;
				qcom,mdss-dsi-bl-dcs-command-state = "dsi_lp_mode";
				qcom,mdss-dsi-bl-max-level = <0xff>;
				qcom,mdss-dsi-bl-min-level = <0x1>;
				qcom,mdss-dsi-bl-pmic-control-type = "bl_ctrl_dcs";
				qcom,mdss-dsi-bllp-eof-power-mode;
				qcom,mdss-dsi-bllp-power-mode;
				qcom,mdss-dsi-border-color = <0x0>;
				qcom,mdss-dsi-bpp = <0x18>;
				qcom,mdss-dsi-dma-trigger = "trigger_sw";
				qcom,mdss-dsi-h-back-porch = <0x50>;
				qcom,mdss-dsi-h-front-porch = <0x50>;
				qcom,mdss-dsi-h-left-border = <0x0>;
				qcom,mdss-dsi-h-pulse-width = <0xa>;
				qcom,mdss-dsi-h-right-border = <0x0>;
				qcom,mdss-dsi-h-sync-pulse = <0x0>;
				qcom,mdss-dsi-h-sync-skew = <0x0>;
				qcom,mdss-dsi-lane-0-state;
				qcom,mdss-dsi-lane-1-state;
				qcom,mdss-dsi-lane-2-state;
				qcom,mdss-dsi-lane-3-state;
				qcom,mdss-dsi-lane-map = "lane_map_0123";
				qcom,mdss-dsi-lp11-init;
				qcom,mdss-dsi-mdp-trigger = "none";
				qcom,mdss-dsi-off-command = [05 01 00 00 14 00 02 28 00 05 01 00 00 78 00 02 10 00];
				qcom,mdss-dsi-off-command-state = "dsi_lp_mode";
				qcom,mdss-dsi-on-command = [15 01 00 00 00 00 02 b0 05 15 01 00 00 00 00 02 b1 60 15 01 00 00 00 00 02 c8 20 15 01 00 00 00 00 02 b0 00 15 01 00 00 00 00 02 b2 12 15 01 00 00 00 00 02 b3 00 15 01 00 00 00 00 02 b4 a0 15 01 00 00 00 00 02 b6 00 15 01 00 00 00 00 02 b8 c1 15 01 00 00 00 00 02 b9 88 15 01 00 00 00 00 02 ba 83 15 01 00 00 00 00 02 be 23 15 01 00 00 00 00 02 bf 19 15 01 00 00 00 00 02 cb 1d 15 01 00 00 00 00 02 cd 1d 15 01 00 00 00 00 02 d1 11 15 01 00 00 00 00 02 b0 01 15 01 00 00 00 00 02 c0 00 15 01 00 00 00 00 02 c1 00 15 01 00 00 00 00 02 c2 01 15 01 00 00 00 00 02 c3 01 15 01 00 00 00 00 02 c4 00 15 01 00 00 00 00 02 c5 00 15 01 00 00 00 00 02 c6 25 15 01 00 00 00 00 02 c7 25 15 01 00 00 00 00 02 c8 00 15 01 00 00 00 00 02 c9 00 15 01 00 00 00 00 02 ca 25 15 01 00 00 00 00 02 cb 25 15 01 00 00 00 00 02 cc 00 15 01 00 00 00 00 02 cd 09 15 01 00 00 00 00 02 ce 09 15 01 00 00 00 00 02 cf 0b 15 01 00 00 00 00 02 d0 0b 15 01 00 00 00 00 02 d1 05 15 01 00 00 00 00 02 d2 05 15 01 00 00 00 00 02 d3 07 15 01 00 00 00 00 02 d4 07 15 01 00 00 00 00 02 d5 00 15 01 00 00 00 00 02 d6 00 15 01 00 00 00 00 02 d7 00 15 01 00 00 00 00 02 d8 02 15 01 00 00 00 00 02 d9 02 15 01 00 00 00 00 02 da 00 15 01 00 00 00 00 02 db 00 15 01 00 00 00 00 02 dc 25 15 01 00 00 00 00 02 dd 25 15 01 00 00 00 00 02 de 00 15 01 00 00 00 00 02 df 00 15 01 00 00 00 00 02 e0 25 15 01 00 00 00 00 02 e1 25 15 01 00 00 00 00 02 e2 00 15 01 00 00 00 00 02 e3 0a 15 01 00 00 00 00 02 e4 0a 15 01 00 00 00 00 02 e5 0c 15 01 00 00 00 00 02 e6 0c 15 01 00 00 00 00 02 e7 06 15 01 00 00 00 00 02 e8 06 15 01 00 00 00 00 02 e9 08 15 01 00 00 00 00 02 ea 08 15 01 00 00 00 00 02 eb 00 15 01 00 00 00 00 02 ec c0 15 01 00 00 00 00 02 b0 02 15 01 00 00 00 00 02 c0 06 15 01 00 00 00 00 02 c1 0a 15 01 00 00 00 00 02 c2 16 15 01 00 00 00 00 02 c3 1e 15 01 00 00 00 00 02 c4 2c 15 01 00 00 00 00 02 c5 28 15 01 00 00 00 00 02 c6 27 15 01 00 00 00 00 02 c7 28 15 01 00 00 00 00 02 c8 26 15 01 00 00 00 00 02 c9 20 15 01 00 00 00 00 02 ca 22 15 01 00 00 00 00 02 cb 1f 15 01 00 00 00 00 02 cc 26 15 01 00 00 00 00 02 cd 23 15 01 00 00 00 00 02 ce 2d 15 01 00 00 00 00 02 cf 2a 15 01 00 00 00 00 02 d0 2f 15 01 00 00 00 00 02 d1 30 15 01 00 00 00 00 02 d2 30 15 01 00 00 00 00 02 d3 30 15 01 00 00 00 00 02 d4 19 15 01 00 00 00 00 02 d5 1f 15 01 00 00 00 00 02 d6 06 15 01 00 00 00 00 02 d7 0a 15 01 00 00 00 00 02 d8 16 15 01 00 00 00 00 02 d9 1e 15 01 00 00 00 00 02 da 2c 15 01 00 00 00 00 02 db 28 15 01 00 00 00 00 02 dc 27 15 01 00 00 00 00 02 dd 28 15 01 00 00 00 00 02 de 26 15 01 00 00 00 00 02 df 20 15 01 00 00 00 00 02 e0 22 15 01 00 00 00 00 02 e1 1f 15 01 00 00 00 00 02 e2 26 15 01 00 00 00 00 02 e3 23 15 01 00 00 00 00 02 e4 2d 15 01 00 00 00 00 02 e5 2a 15 01 00 00 00 00 02 e6 2f 15 01 00 00 00 00 02 e7 30 15 01 00 00 00 00 02 e8 30 15 01 00 00 00 00 02 e9 30 15 01 00 00 00 00 02 ea 19 15 01 00 00 00 00 02 eb 1f 15 01 00 00 00 00 02 b0 03 15 01 00 00 00 00 02 c8 09 15 01 00 00 00 00 02 c9 07 15 01 00 00 00 00 02 c5 3a 15 01 00 00 00 00 02 ca 41 15 01 00 00 00 00 02 de 3a 15 01 00 00 00 00 02 b0 06 15 01 00 00 00 00 02 c0 a5 15 01 00 00 00 00 02 d5 44 15 01 00 00 00 00 02 c0 00 15 01 00 00 00 00 02 b0 00 15 01 00 00 00 00 02 f2 30 15 01 00 00 00 00 02 b0 04 15 01 00 00 00 00 02 b3 00 15 01 00 00 00 00 02 b5 04 15 01 00 00 00 00 02 b6 00 15 01 00 00 64 00 02 11 00 15 01 00 00 0a 00 02 29 00];
				qcom,mdss-dsi-on-command-state = "dsi_lp_mode";
				qcom,mdss-dsi-panel-controller = <0xffffffff>;
				qcom,mdss-dsi-panel-destination = "display_1";
				qcom,mdss-dsi-panel-framerate = <0x3c>;
				qcom,mdss-dsi-panel-height = <0x500>;
				qcom,mdss-dsi-panel-max-error-count = <0x3>;
				qcom,mdss-dsi-panel-name = "hx8252 800p video mode dsi panel";
				qcom,mdss-dsi-panel-on-check-value = <0x9c>;
				qcom,mdss-dsi-panel-status-check-mode = "reg_read";
				qcom,mdss-dsi-panel-status-command = <0x6010001 0x500010a>;
				qcom,mdss-dsi-panel-status-command-state = "dsi_lp_mode";
				qcom,mdss-dsi-panel-status-read-length = <0x3>;
				qcom,mdss-dsi-panel-status-valid-params = <0x1>;
				qcom,mdss-dsi-panel-status-value = <0x14>;
				qcom,mdss-dsi-panel-timings-phy-12nm = <0xb070a03 0x50304>;
				qcom,mdss-dsi-panel-type = "dsi_video_mode";
				qcom,mdss-dsi-panel-width = <0x320>;
				qcom,mdss-dsi-post-init-delay = <0x1>;
				qcom,mdss-dsi-reset-sequence = <0x1 0x14 0x0 0x1 0x1 0x14>;
				qcom,mdss-dsi-stream = <0x0>;
				qcom,mdss-dsi-t-clk-post = <0x10>;
				qcom,mdss-dsi-t-clk-pre = <0x1a>;
				qcom,mdss-dsi-traffic-mode = "burst_mode";
				qcom,mdss-dsi-tx-eot-append;
				qcom,mdss-dsi-underflow-color = <0xff>;
				qcom,mdss-dsi-v-back-porch = <0x14>;
				qcom,mdss-dsi-v-bottom-border = <0x0>;
				qcom,mdss-dsi-v-front-porch = <0x3c>;
				qcom,mdss-dsi-v-pulse-width = <0x4>;
				qcom,mdss-dsi-v-top-border = <0x0>;
				qcom,mdss-dsi-virtual-channel-id = <0x0>;
				qcom,mdss-pan-physical-height-dimension = <0xd9>;
				qcom,mdss-pan-physical-width-dimension = <0x87>;
			};
		};
	};

	fragment@31 {
		target = <0xffffffff>;

		__overlay__ {

			dsi_panel_pwr_supply {
				#address-cells = <0x1>;
				#size-cells = <0x0>;
				phandle = <0x5>;

				qcom,panel-supply-entry@0 {
					qcom,supply-disable-load = <0x64>;
					qcom,supply-enable-load = <0x186a0>;
					qcom,supply-max-voltage = <0x1d0d80>;
					qcom,supply-min-voltage = <0x1a9c80>;
					qcom,supply-name = "vddio";
					reg = <0x1>;
				};
			};

			dsi_pm660_panel_pwr_supply {
				#address-cells = <0x1>;
				#size-cells = <0x0>;
				phandle = <0x1c>;

				qcom,panel-supply-entry@0 {
					qcom,supply-disable-load = <0x64>;
					qcom,supply-enable-load = <0x186a0>;
					qcom,supply-max-voltage = <0x2ab980>;
					qcom,supply-min-voltage = <0x2ab980>;
					qcom,supply-name = "vdd";
					reg = <0x0>;
				};

				qcom,panel-supply-entry@1 {
					qcom,supply-disable-load = <0x64>;
					qcom,supply-enable-load = <0x186a0>;
					qcom,supply-max-voltage = <0x1b7740>;
					qcom,supply-min-voltage = <0x1b7740>;
					qcom,supply-name = "vddio";
					reg = <0x1>;
				};
			};
		};
	};

	fragment@32 {
		target = <0xffffffff>;

		__overlay__ {
			qcom,mdss-pref-prim-intf = "dsi";
		};
	};

	fragment@33 {
		target = <0xffffffff>;

		__overlay__ {

			nfc_clk {

				nfc_clk_default {
					function = "normal";
					input-enable;
					phandle = <0x6>;
					pins = "gpio2";
					power-source = <0x1>;
				};
			};
		};
	};

	fragment@34 {
		target = <0xffffffff>;

		__overlay__ {
			#address-cells = <0x1>;
			#size-cells = <0x0>;
			status = "ok";

			nq@28 {
				clock-names = "ref_clk";
				clocks = <0xffffffff 0x498938e5>;
				compatible = "qcom,nq-nci";
				interrupt-names = "nfc_irq";
				interrupt-parent = <0xffffffff>;
				interrupts = <0x11 0x0>;
				pinctrl-0 = <0xffffffff 0xffffffff 0x6>;
				pinctrl-1 = <0xffffffff 0xffffffff>;
				pinctrl-names = "nfc_active", "nfc_suspend";
				qcom,clk-src = "BBCLK2";
				qcom,nq-clkreq = <0xffffffff 0x2 0x0>;
				qcom,nq-firm = <0xffffffff 0x82 0x0>;
				qcom,nq-irq = <0xffffffff 0x11 0x0>;
				qcom,nq-ven = <0xffffffff 0x10 0x0>;
				reg = <0x28>;
			};
		};
	};

	fragment@35 {
		target = <0xffffffff>;

		__overlay__ {
			hw-config = "single_dsi";
		};
	};

	fragment@36 {
		target = <0xffffffff>;

		__overlay__ {
			pinctrl-0 = <0xffffffff 0xffffffff>;
			pinctrl-1 = <0xffffffff 0xffffffff>;
			pinctrl-names = "mdss_default", "mdss_sleep";
			qcom,dsi-pref-prim-pan = <0x7>;
			qcom,platform-bklight-en-gpio = <0xffffffff 0x5d 0x0>;
			qcom,platform-enable-gpio = <0xffffffff 0x5e 0x0>;
			qcom,platform-reset-gpio = <0xffffffff 0x3c 0x0>;
			qcom,platform-te-gpio = <0xffffffff 0x18 0x0>;
		};
	};

	fragment@4 {
		target = <0xffffffff>;

		__overlay__ {
			status = "ok";
		};
	};

	fragment@5 {
		target = <0xffffffff>;

		__overlay__ {

			fpc1020 {
				compatible = "fpc,fpc1020";
				fpc,enable-on-boot;
				fpc,gpio_irq = <0xffffffff 0x30 0x0>;
				fpc,gpio_rst = <0xffffffff 0x7c 0x0>;
				interrupt-parent = <0xffffffff>;
				interrupts = <0x30 0x0>;
				pinctrl-0 = <0xffffffff>;
				pinctrl-1 = <0xffffffff>;
				pinctrl-2 = <0xffffffff>;
				pinctrl-names = "fpc1020_reset_reset", "fpc1020_reset_active", "fpc1020_irq_active";
				vcc_spi-supply = <0xffffffff>;
				vdd_ana-supply = <0xffffffff>;
				vdd_io-supply = <0xffffffff>;
			};

			gpio_keys {
				compatible = "gpio-keys";
				input-name = "gpio-keys";
				pinctrl-0 = <0xffffffff>;
				pinctrl-names = "default";

				vol_up {
					debounce-interval = <0xf>;
					gpio-key,wakeup;
					gpios = <0xffffffff 0x5b 0x1>;
					label = "volume_up";
					linux,can-disable;
					linux,code = <0x73>;
					linux,input-type = <0x1>;
				};
			};
		};
	};

	fragment@6 {
		target = <0xffffffff>;

		__overlay__ {
			pinctrl-0 = <0xffffffff 0xffffffff 0xffffffff 0xffffffff>;
			pinctrl-1 = <0xffffffff 0xffffffff 0xffffffff 0xffffffff>;
			pinctrl-names = "active", "sleep";
			qcom,bus-speed-mode = "HS400_1p8v", "HS200_1p8v", "DDR_1p8v";
			qcom,clk-rates = <0x61a80 0x1312d00 0x17d7840 0x2faf080 0x5f5e100 0xb71b000 0x16e36000>;
			qcom,nonremovable;
			qcom,vdd-current-level = <0xc8 0x61a80>;
			qcom,vdd-io-always-on;
			qcom,vdd-io-current-level = <0xc8 0x4f588>;
			qcom,vdd-io-lpm-sup;
			qcom,vdd-io-voltage-level = <0x1b7740 0x1b7740>;
			qcom,vdd-voltage-level = <0x2c4020 0x2c4020>;
			status = "ok";
			vdd-io-supply = <0xffffffff>;
			vdd-supply = <0xffffffff>;
		};
	};

	fragment@7 {
		target = <0xffffffff>;

		__overlay__ {
			cd-gpios = <0xffffffff 0x43 0x0>;
			pinctrl-0 = <0xffffffff 0xffffffff 0xffffffff 0xffffffff>;
			pinctrl-1 = <0xffffffff 0xffffffff 0xffffffff>;
			pinctrl-names = "active", "sleep";
			qcom,bus-speed-mode = "SDR12", "SDR25", "SDR50", "DDR50", "SDR104";
			qcom,clk-rates = <0x61a80 0x1312d00 0x17d7840 0x2faf080 0x5f5e100 0xbebc200>;
			qcom,vdd-current-level = <0x3a98 0xc3500>;
			qcom,vdd-io-current-level = <0xc8 0x55f0>;
			qcom,vdd-io-voltage-level = <0x1b7740 0x2d0370>;
			qcom,vdd-voltage-level = <0x2d0370 0x2d0370>;
			status = "ok";
			vdd-io-supply = <0xffffffff>;
			vdd-supply = <0xffffffff>;
		};
	};

	fragment@8 {
		target = <0xffffffff>;

		__overlay__ {

			config {
				bias-disable = <0x0>;
				drive-strength = <0x8>;
				output-high;
				pins = "gpio60", "gpio93", "gpio94";
			};

			mux {
				function = "gpio";
				pins = "gpio60", "gpio93", "gpio94";
			};
		};
	};

	fragment@9 {
		target = <0xffffffff>;

		__overlay__ {

			config {
				bias-pull-down;
				drive-strength = <0x2>;
				pins = "gpio60", "gpio93", "gpio94";
			};

			mux {
				function = "gpio";
				pins = "gpio60", "gpio93", "gpio94";
			};
		};
	};
};
